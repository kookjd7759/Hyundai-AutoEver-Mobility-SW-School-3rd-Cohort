AUTOSAR XML (schema 4-0-3)
package /Os
  module config Os: implementation-config-variant=VARIANT-PRE-COMPILE, module-description=BswImplementation_Os
    6 x OsAlarm, all with OsAlarmCounterRef=OsCounter_0:
      OsAlarm_BSW_5ms_Mem
        OsAlarmAction
          OsAlarmActivateTask: OsAlarmActivateTaskRef=OsTask_BSW_FG1_5ms_Mem
      OsAlarm_BSW_5ms_Com
        OsAlarmAction
          OsAlarmActivateTask: OsAlarmActivateTaskRef=OsTask_BSW_FG1_5ms_Com
      OsAlarm_BSW_10ms
        OsAlarmAction
          OsAlarmActivateTask: OsAlarmActivateTaskRef=OsTask_BSW_FG1_10ms
      OsAlarm_ASW_10ms
        OsAlarmAction
          OsAlarmActivateTask: OsAlarmActivateTaskRef=OsTask_ASW_FG1_10ms
      OsAlarm_ASW_100ms
        OsAlarmAction
          OsAlarmActivateTask: OsAlarmActivateTaskRef=OsTask_ASW_FG1_100ms
      OsAlarm_Test_1s
        OsAlarmAction
          OsAlarmActivateTask: OsAlarmActivateTaskRef=OsTask_Test_1s
        OsAlarmAutostart: OsAlarmAlarmTime=500000, OsAlarmAutostartType=RELATIVE, OsAlarmCycleTime=1000000, OsAlarmAppModeRef=OsAppMode0
    OsAppMode0 (OsAppMode)
    OsApplication0 (OsApplication):
      category = TOOL_CONFIGURED
      OsApplicationCoreAssignment = 0
      OsTrusted = 1
      OsAppAlarmRef = OsAlarm_BSW_5ms_Mem
      OsAppAlarmRef = OsAlarm_BSW_10ms
      OsAppAlarmRef = OsAlarm_ASW_10ms
      OsAppAlarmRef = OsAlarm_BSW_5ms_Com
      OsAppCounterRef = OsCounter_0
      OsAppIsrRef = Adc_EndGroupConvUnit0
      OsAppIsrRef = EMIOS_0_CH_2_CH_3_ISR
      OsAppIsrRef = EMIOS_0_CH_6_CH_7_ISR
      OsAppIsrRef = Gpt_PIT_TIMER_1_ISR
      OsAppIsrRef = Can_IsrFCB_BO
      OsAppIsrRef = Can_IsrFCB_MB_00_03
      OsAppIsrRef = Can_IsrFCB_MB_04_07
      OsAppIsrRef = Can_IsrFCB_MB_08_11
      OsAppIsrRef = Can_IsrFCB_MB_12_15
      OsAppIsrRef = Can_IsrFCB_MB_16_31
      OsAppIsrRef = Can_IsrFCB_MB_32_63
      OsAppIsrRef = Gpt_PIT_TIMER_3_ISR
      OsAppTaskRef = OsTask_ASW_FG1_10ms
      OsAppTaskRef = OsTask_BSW_FG1_10ms
      OsAppTaskRef = OsTask_BSW_FG1_5ms_Mem
      OsAppTaskRef = OsTask_BSW_FG1_IOManager
      OsAppTaskRef = OsTask_BSW_FG2_IOManager
      OsAppTaskRef = OsTask_BSW_FG2_WdgMAPI
      OsAppTaskRef = OsTask_ASW_FG2_WdgMTestMode
      OsAppTaskRef = OsTask_BSW_Init
      OsAppTaskRef = OsTask_BSW_System_Idle
      OsAppTaskRef = OsTask_BSW_AppModeRequest
      OsAppTaskRef = OsTask_BSW_Mem_Process
      OsAppTaskRef = OsTask_BSW_FG1_5ms_Com
      OsAppTaskRef = OsTask_BSW_ComMModeRequest
      OsAppAlarmRef = OsAlarm_ASW_100ms
      OsAppTaskRef = OsTask_ASW_FG1_100ms
      OsAppTaskRef = OsTask_ASW_TestModeManager
      OsAppIsrRef = EMIOS_0_CH_4_CH_5_ISR
      OsAppTaskRef = OsTask_LED_Init
      OsAppAlarmRef = OsAlarm_Test_1s
      OsAppTaskRef = OsTask_Test_1s
      OsApplicationHooks0 (OsApplicationHooks): OsAppErrorHook=0, OsAppShutdownHook=0, OsAppStartupHook=0
    OsCounter_0 (OsCounter): OsCounterMaxAllowedValue=0xFFFFFFFF, OsCounterMinCycle=1, OsCounterTicksPerBase=1, OsCounterType=HARDWARE
    13 x OsIsr, all with OsIsrCategory=CATEGORY_2, OsPriority=1:
      Adc_EndGroupConvUnit0
        OsIrqChannel
          EXTERNAL: OsIrqNumber=62
      Can_IsrFCB_BO
        OsIrqChannel
          EXTERNAL: OsIrqNumber=86
      Can_IsrFCB_MB_00_03
        OsIrqChannel
          EXTERNAL: OsIrqNumber=88
      Can_IsrFCB_MB_04_07
        OsIrqChannel
          EXTERNAL: OsIrqNumber=89
      Can_IsrFCB_MB_08_11
        OsIrqChannel
          EXTERNAL: OsIrqNumber=90
      Can_IsrFCB_MB_12_15
        OsIrqChannel
          EXTERNAL: OsIrqNumber=91
      Can_IsrFCB_MB_16_31
        OsIrqChannel
          EXTERNAL: OsIrqNumber=92
      Can_IsrFCB_MB_32_63
        OsIrqChannel
          EXTERNAL: OsIrqNumber=93
      EMIOS_0_CH_2_CH_3_ISR
        OsIrqChannel
          EXTERNAL: OsIrqNumber=142
      EMIOS_0_CH_6_CH_7_ISR
        OsIrqChannel
          EXTERNAL: OsIrqNumber=144
      Gpt_PIT_TIMER_1_ISR
        OsIrqChannel
          EXTERNAL: OsIrqNumber=60
      Gpt_PIT_TIMER_3_ISR
        OsIrqChannel
          EXTERNAL: OsIrqNumber=127
      EMIOS_0_CH_4_CH_5_ISR: OsIsrResourceRef=RES_ACCESS_PROTECTION
        OsIrqChannel
          EXTERNAL: OsIrqNumber=143
    OsOS:
      OsNumberOfCores = 1
      OsScalabilityClass = SC1
      OsStackMonitoring = 1
      OsStatus = EXTENDED
      OsUseGetServiceId = 1
      OsUseParameterAccess = 1
      OsUseResScheduler = 1
      OsCommonStackSize = 1024
      OsDebugLevel = 0
      OsIsrHooks = 1
      OsIsrStackSize = 1024
      OsPattern = 0xABCDEF01
      OsPatternSize = FOUR
      OsHooks: OsErrorHook=1, OsPostTaskHook=1, OsPreTaskHook=1, OsProtectionHook=0, OsShutdownHook=1, OsStartupHook=1
      OsTargetMCU
        MPC5606B: OsClockDivider=1, OsClockMultiplier=1, OsClockFrequency=64000
          OsInternalRAM
            TRUE: Address=0x40000000, Size=0x00013FFF
          OsInternalROM
            TRUE: Address=0x00001000, Size=0x000FEFFF
          OsSysTimer
            HWCOUNTER: OsIsrPriority=15, OsCounter=OsCounter_0
              OsTimerHardware
                STM: OsChannel=0, OsFreeze=1
                  OsPrescaler
                    OS: OsValue=63
    4 x OsResource:
      OsResource_Sleep: OsResourceProperty=STANDARD
      OsResource_FG1: OsResourceProperty=INTERNAL
      OsResource_FG2: OsResourceProperty=INTERNAL
      RES_ACCESS_PROTECTION: OsResourceProperty=STANDARD
    17 x OsTask, all with OsTaskActivation=1, OsTaskSchedule=FULL:
      OsTask_BSW_ComMModeRequest: OsTaskPriority=253
      OsTask_BSW_AppModeRequest: OsTaskPriority=250
      OsTask_BSW_FG2_IOManager: OsTaskPriority=220, OsTaskResourceRef=OsResource_FG2
      OsTask_BSW_FG2_WdgMAPI: OsTaskPriority=210, OsTaskResourceRef=OsResource_FG2
      OsTask_ASW_FG2_WdgMTestMode: OsTaskPriority=205, OsTaskResourceRef=OsResource_FG2
      OsTask_BSW_FG1_5ms_Mem: OsTaskPriority=198, OsTaskResourceRef=OsResource_FG1
      OsTask_BSW_FG1_5ms_Com: OsTaskPriority=197, OsTaskResourceRef=OsResource_FG1
      OsTask_BSW_FG1_IOManager: OsTaskPriority=195, OsTaskResourceRef=OsResource_FG1
      OsTask_BSW_FG1_10ms: OsTaskPriority=180, OsTaskResourceRef=OsResource_FG1
      OsTask_ASW_FG1_10ms: OsTaskPriority=140, OsTaskResourceRef=OsResource_FG1
      OsTask_BSW_Init: OsTaskPriority=98
        OsTaskAutostart: OsTaskAppModeRef=OsAppMode0
      OsTask_BSW_Mem_Process: OsTaskPriority=99
      OsTask_BSW_System_Idle: OsTaskPriority=0
        OsTaskAutostart: OsTaskAppModeRef=OsAppMode0
      OsTask_ASW_FG1_100ms: OsTaskPriority=116, OsTaskResourceRef=OsResource_FG1
      OsTask_ASW_TestModeManager: OsTaskPriority=130
      OsTask_LED_Init: OsTaskPriority=1
      OsTask_Test_1s: OsTaskPriority=2
