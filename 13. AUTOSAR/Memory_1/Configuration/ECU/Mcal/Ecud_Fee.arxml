AUTOSAR XML (schema 4-0-3)
package /Fee
  module config Fee: implementation-config-variant=VARIANT-PRE-COMPILE, module-description=BswImplementation_Fee
    FeeClusterGroup0 (FeeClusterGroup)
      FeeCluster_0 (FeeCluster)
        FeeSector_0 (FeeSector): FeeSectorRef=FlsSector_0
      FeeCluster_1 (FeeCluster)
        FeeSector_1 (FeeSector): FeeSectorRef=FlsSector_1
    FeeClusterGroup1 (FeeClusterGroup)
      FeeCluster_2 (FeeCluster)
        FeeSector_2 (FeeSector): FeeSectorRef=FlsSector_2
      FeeCluster_3 (FeeCluster)
        FeeSector_3 (FeeSector): FeeSectorRef=FlsSector_3
    17 x FeeBlockConfiguration, all with FeeImmediateData=0, FeeNumberOfWriteCycles=0, FeeDeviceIndex=FlsGeneral:
      FeeBlock_ConfigID: FeeBlockNumber=2, FeeBlockSize=4, FeeClusterGroupRef=FeeClusterGroup0
      FeeBlock_ConfigID_copy1: FeeBlockNumber=3, FeeBlockSize=4, FeeClusterGroupRef=FeeClusterGroup0
      FeeBlock_DemNonVolatileData: FeeBlockNumber=4, FeeBlockSize=11, FeeClusterGroupRef=FeeClusterGroup1
      FeeBlock_DemPriEvtMem_0: FeeBlockNumber=8, FeeBlockSize=20, FeeClusterGroupRef=FeeClusterGroup1
      FeeBlock_DemPriEvtMem_1: FeeBlockNumber=10, FeeBlockSize=20, FeeClusterGroupRef=FeeClusterGroup0
      FeeBlock_DemPriEvtMem_2: FeeBlockNumber=12, FeeBlockSize=20, FeeClusterGroupRef=FeeClusterGroup1
      FeeBlock_IntTst_TestBlock1: FeeBlockNumber=14, FeeBlockSize=7, FeeClusterGroupRef=FeeClusterGroup0
      FeeBlock_IntTst_TestBlock2: FeeBlockNumber=16, FeeBlockSize=9, FeeClusterGroupRef=FeeClusterGroup0
      FeeBlock_IntTst_TestBlock3: FeeBlockNumber=18, FeeBlockSize=2, FeeClusterGroupRef=FeeClusterGroup0
      FeeBlock_DemEventStatusNvRamBlock: FeeBlockNumber=6, FeeBlockSize=52, FeeClusterGroupRef=FeeClusterGroup1
      FeeBlock_DemEventStatusNvRamBlock_copy1: FeeBlockNumber=7, FeeBlockSize=52, FeeClusterGroupRef=FeeClusterGroup1
      FeeBlock_DemPriEvtMem_2_copy1: FeeBlockNumber=13, FeeBlockSize=20, FeeClusterGroupRef=FeeClusterGroup1
      FeeBlock_DemPriEvtMem_1_copy1: FeeBlockNumber=11, FeeBlockSize=20, FeeClusterGroupRef=FeeClusterGroup0
      FeeBlock_DemPriEvtMem_0_copy1: FeeBlockNumber=9, FeeBlockSize=20, FeeClusterGroupRef=FeeClusterGroup1
      FeeBlock_DemNonVolatileData_copy1: FeeBlockNumber=5, FeeBlockSize=11, FeeClusterGroupRef=FeeClusterGroup1
      FeeBlock_IntTst_TestBlock4: FeeBlockNumber=20, FeeBlockSize=10, FeeClusterGroupRef=FeeClusterGroup0
      FeeBlock_IntTst_TestBlock5: FeeBlockNumber=22, FeeBlockSize=14, FeeClusterGroupRef=FeeClusterGroup0
    FeeGeneral:
      FeeDevErrorDetect = 1
      FeeIndex = 0
      FeeNvmJobEndNotification = NvM_JobEndNotification
      FeeNvmJobErrorNotification = NvM_JobErrorNotification
      FeePollingMode = 0
      FeeSetModeSupported = 1
      FeeVersionInfoApi = 1
      FeeVirtualPageSize = 16
      FeeDataBufferSize = 48
      FeeBlockAlwaysAvailable = 0
    CommonPublishedInformation: ArReleaseMajorVersion=4, ArReleaseMinorVersion=0, ArReleaseRevisionVersion=3, ModuleId=21, SwMajorVersion=1, SwMinorVersion=0, VendorId=43
    FeePublishedInformation: FeeBlockOverhead=0, FeeMaximumBlockingTime=0.0, FeePageOverhead=0
