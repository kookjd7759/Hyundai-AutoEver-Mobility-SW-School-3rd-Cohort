AUTOSAR XML (schema 4-0-3)
package /AUTOSAR
  module config NvM: implementation-config-variant=VARIANT-PRE-COMPILE, module-description=BswImplementation_NvM
    11 x NvMBlockDescriptor, all with NvMBlockJobPriority=1, NvMBlockUseSyncMechanism=0, NvMBlockWriteProt=0, NvMNvramDeviceId=0, NvMResistantToChangedSw=0, NvMStaticBlockIDCheck=0, NvMWriteBlockOnce=0, NvMWriteVerification=0, NvMDefaultROMCRCEnabled=0:
      NvMBlock_ConfigID: NvMBlockCrcType=NVM_CRC16, NvMBlockManagementType=NVM_BLOCK_REDUNDANT, NvMBlockUseCrc=1, NvMBswMBlockStatusInformation=0, NvMCalcRamBlockCrc=1, NvMMaxNumOfReadRetries=1, NvMMaxNumOfWriteRetries=1, NvMNvBlockBaseNumber=1, NvMNvBlockLength=2, NvMNvBlockNum=2, NvMNvramBlockIdentifier=1, NvMRamBlockDataAddress=ConfigIDRamBlock, NvMRomBlockNum=0, NvMSelectBlockForReadAll=1, NvMSelectBlockForWriteAll=1, NvMSingleBlockCallback=Rte_Call_NvM_PNJF_NvMBlock_ConfigID_JobFinished, NvMWriteVerificationDataSize=0
        NvMTargetBlockReference
          NvMFeeRef: NvMNameOfFeeBlock=FeeBlock_ConfigID
      NvMBlock_DemNonVolatileData: NvMBlockCrcType=NVM_CRC16, NvMBlockManagementType=NVM_BLOCK_REDUNDANT, NvMBlockUseCrc=1, NvMBswMBlockStatusInformation=0, NvMCalcRamBlockCrc=1, NvMMaxNumOfReadRetries=1, NvMMaxNumOfWriteRetries=1, NvMNvBlockBaseNumber=2, NvMNvBlockLength=9, NvMNvBlockNum=2, NvMNvramBlockIdentifier=2, NvMRamBlockDataAddress=Dem_NonVolatileData, NvMRomBlockNum=0, NvMSelectBlockForReadAll=1, NvMSelectBlockForWriteAll=1, NvMWriteVerificationDataSize=0
        NvMTargetBlockReference
          NvMFeeRef: NvMNameOfFeeBlock=FeeBlock_DemNonVolatileData
      NvMBlock_DemEventStatusNvRamBlock: NvMBlockCrcType=NVM_CRC16, NvMBlockManagementType=NVM_BLOCK_REDUNDANT, NvMBlockUseCrc=1, NvMBswMBlockStatusInformation=0, NvMCalcRamBlockCrc=1, NvMMaxNumOfReadRetries=1, NvMMaxNumOfWriteRetries=1, NvMNvBlockBaseNumber=3, NvMNvBlockLength=50, NvMNvBlockNum=2, NvMNvramBlockIdentifier=3, NvMRomBlockNum=0, NvMSelectBlockForReadAll=1, NvMSelectBlockForWriteAll=1, NvMWriteVerificationDataSize=1, NvMRamBlockDataAddress=Dem_EventStatusNvRamData
        NvMTargetBlockReference
          NvMFeeRef: NvMNameOfFeeBlock=FeeBlock_DemEventStatusNvRamBlock
      NvMBlock_DemPrimaryEventMemory_0: NvMBlockCrcType=NVM_CRC16, NvMBlockManagementType=NVM_BLOCK_REDUNDANT, NvMBlockUseCrc=1, NvMBswMBlockStatusInformation=0, NvMCalcRamBlockCrc=1, NvMMaxNumOfReadRetries=1, NvMMaxNumOfWriteRetries=1, NvMNvBlockBaseNumber=4, NvMNvBlockLength=18, NvMNvBlockNum=2, NvMNvramBlockIdentifier=4, NvMRamBlockDataAddress=Dem_PrimaryEventMemory[0], NvMRomBlockNum=0, NvMSelectBlockForReadAll=1, NvMSelectBlockForWriteAll=1, NvMWriteVerificationDataSize=0
        NvMTargetBlockReference
          NvMFeeRef: NvMNameOfFeeBlock=FeeBlock_DemPriEvtMem_0
      NvMBlock_DemPrimaryEventMemory_1: NvMBlockCrcType=NVM_CRC16, NvMBlockManagementType=NVM_BLOCK_REDUNDANT, NvMBlockUseCrc=1, NvMBswMBlockStatusInformation=0, NvMCalcRamBlockCrc=1, NvMMaxNumOfReadRetries=1, NvMMaxNumOfWriteRetries=1, NvMNvBlockBaseNumber=5, NvMNvBlockLength=18, NvMNvBlockNum=2, NvMNvramBlockIdentifier=5, NvMRamBlockDataAddress=Dem_PrimaryEventMemory[1], NvMRomBlockNum=0, NvMSelectBlockForReadAll=1, NvMSelectBlockForWriteAll=1, NvMWriteVerificationDataSize=0
        NvMTargetBlockReference
          NvMFeeRef: NvMNameOfFeeBlock=FeeBlock_DemPriEvtMem_1
      NvMBlock_DemPrimaryEventMemory_2: NvMBlockCrcType=NVM_CRC16, NvMBlockManagementType=NVM_BLOCK_REDUNDANT, NvMBlockUseCrc=1, NvMBswMBlockStatusInformation=0, NvMCalcRamBlockCrc=1, NvMMaxNumOfReadRetries=1, NvMMaxNumOfWriteRetries=1, NvMNvBlockBaseNumber=6, NvMNvBlockLength=18, NvMNvBlockNum=2, NvMNvramBlockIdentifier=6, NvMRamBlockDataAddress=Dem_PrimaryEventMemory[2], NvMRomBlockNum=0, NvMSelectBlockForReadAll=1, NvMSelectBlockForWriteAll=1, NvMWriteVerificationDataSize=0
        NvMTargetBlockReference
          NvMFeeRef: NvMNameOfFeeBlock=FeeBlock_DemPriEvtMem_2
      NvMBlock_IntTst_TestBlock1: NvMBlockManagementType=NVM_BLOCK_NATIVE, NvMBlockUseCrc=0, NvMBswMBlockStatusInformation=0, NvMCalcRamBlockCrc=0, NvMMaxNumOfReadRetries=3, NvMMaxNumOfWriteRetries=3, NvMNvBlockBaseNumber=7, NvMNvBlockLength=7, NvMNvBlockNum=1, NvMNvramBlockIdentifier=7, NvMRamBlockDataAddress=NvMBlock_IntTst_TestBlock1_Ram_Block, NvMRomBlockNum=0, NvMSelectBlockForReadAll=1, NvMSelectBlockForWriteAll=0, NvMSingleBlockCallback=Rte_Call_NvM_PNJF_NvMBlock_IntTst_TestBlock1_JobFinished, NvMWriteVerificationDataSize=10
        NvMTargetBlockReference0 (NvMTargetBlockReference)
          NvMFeeRef: NvMNameOfFeeBlock=FeeBlock_IntTst_TestBlock1
      NvMBlock_IntTst_TestBlock2: NvMBlockCrcType=NVM_CRC16, NvMBlockManagementType=NVM_BLOCK_NATIVE, NvMBlockUseCrc=1, NvMBswMBlockStatusInformation=1, NvMCalcRamBlockCrc=1, NvMMaxNumOfReadRetries=3, NvMMaxNumOfWriteRetries=3, NvMNvBlockBaseNumber=8, NvMNvBlockLength=7, NvMNvBlockNum=1, NvMNvramBlockIdentifier=8, NvMRomBlockNum=1, NvMSelectBlockForReadAll=0, NvMSelectBlockForWriteAll=0, NvMSingleBlockCallback=Rte_Call_NvM_PNJF_NvMBlock_IntTst_TestBlock2_JobFinished, NvMWriteVerificationDataSize=10
        NvMTargetBlockReference0 (NvMTargetBlockReference)
          NvMFeeRef: NvMNameOfFeeBlock=FeeBlock_IntTst_TestBlock2
      NvMBlock_IntTst_TestBlock3: NvMBlockManagementType=NVM_BLOCK_NATIVE, NvMBlockUseCrc=0, NvMBswMBlockStatusInformation=0, NvMCalcRamBlockCrc=0, NvMMaxNumOfReadRetries=3, NvMMaxNumOfWriteRetries=3, NvMNvBlockBaseNumber=9, NvMNvBlockLength=2, NvMNvBlockNum=1, NvMNvramBlockIdentifier=9, NvMRomBlockNum=0, NvMSelectBlockForReadAll=0, NvMSelectBlockForWriteAll=0, NvMSingleBlockCallback=Rte_Call_NvM_PNJF_NvMBlock_IntTst_TestBlock3_JobFinished, NvMWriteVerificationDataSize=0
        NvMTargetBlockReference
          NvMFeeRef: NvMNameOfFeeBlock=FeeBlock_IntTst_TestBlock3
      NvMBlock_IntTst_TestBlock4: NvMBlockUseCrc=0, NvMBswMBlockStatusInformation=0, NvMCalcRamBlockCrc=0, NvMMaxNumOfReadRetries=1, NvMMaxNumOfWriteRetries=1, NvMSelectBlockForReadAll=0, NvMSelectBlockForWriteAll=0, NvMWriteVerificationDataSize=1, NvMBlockManagementType=NVM_BLOCK_NATIVE, NvMNvBlockBaseNumber=10, NvMNvBlockLength=10, NvMNvBlockNum=1, NvMNvramBlockIdentifier=10, NvMRomBlockNum=0, NvMSingleBlockCallback=Rte_Call_NvM_PNJF_NvMBlock_IntTst_TestBlock4_JobFinished
        NvMTargetBlockReference
          NvMFeeRef: NvMNameOfFeeBlock=FeeBlock_IntTst_TestBlock4
      NvMBlock_IntTst_TestBlock5: NvMBlockUseCrc=1, NvMBswMBlockStatusInformation=0, NvMCalcRamBlockCrc=1, NvMMaxNumOfReadRetries=1, NvMMaxNumOfWriteRetries=1, NvMSelectBlockForReadAll=0, NvMSelectBlockForWriteAll=0, NvMWriteVerificationDataSize=1, NvMBlockManagementType=NVM_BLOCK_REDUNDANT, NvMBlockCrcType=NVM_CRC16, NvMNvBlockBaseNumber=11, NvMNvBlockLength=12, NvMNvBlockNum=2, NvMNvramBlockIdentifier=11, NvMRomBlockNum=0, NvMSingleBlockCallback=Rte_Call_NvM_PNJF_NvMBlock_IntTst_TestBlock5_JobFinished
        NvMTargetBlockReference
          NvMFeeRef: NvMNameOfFeeBlock=FeeBlock_IntTst_TestBlock5
    NvMCommon:
      NvMApiConfigClass = NVM_API_CONFIG_CLASS_3
      NvMBswMMultiBlockJobStatusInformation = 1
      NvMCompiledConfigId = 20
      NvMCrcNumOfBytes = 4
      NvMDatasetSelectionBits = 1
      NvMDevErrorDetect = 1
      NvMDrvModeSwitch = 1
      NvMDynamicConfiguration = 0
      NvMJobPrioritization = 0
      NvMMultiBlockCallback = BswM_NvM_CurrentJobMode
      NvMPollingMode = 0
      NvMRepeatMirrorOperations = 0
      NvMSetRamBlockStatusApi = 0
      NvMSizeImmediateJobQueue = 20
      NvMSizeStandardJobQueue = 20
      NvMMainFunctionCallCycle = 0.005
      NvMVersionInfoApi = 1
      NvMTickCountFor1ms = 64000
      NvMMainfunctionTriggerRef = GptChannelConfiguration_Memory
      NvMUserIncludeFiles: NvMUserIncludeFile=App_NvM_Ram.h, NvMUserIncludeFile=Dem_Ram.h, NvMUserIncludeFile=Mem_Integration.h
    NvMDemEventParameterRefs_0 (NvMDemEventParameterRefs):
      NVM_E_INTEGRITY_FAILED = NVM_E_INTEGRITY_FAILED
      NVM_E_LOSS_OF_REDUNDANCY = NVM_E_LOSS_OF_REDUNDANCY
      NVM_E_QUEUE_OVERFLOW = NVM_E_QUEUE_OVERFLOW
      NVM_E_REQ_FAILED = NVM_E_REQ_FAILED
      NVM_E_VERIFY_FAILED = NVM_E_VERIFY_FAILED
      NVM_E_WRITE_PROTECTED = NVM_E_WRITE_PROTECTED
      NVM_E_WRONG_BLOCK_ID = NVM_E_WRONG_BLOCK_ID
