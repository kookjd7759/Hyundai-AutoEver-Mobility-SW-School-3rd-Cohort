AUTOSAR XML (schema 4-0-3)
package /ECU_EXTRACT
  system EcuExtract: category=ECU_EXTRACT
    system mapping DataMappings
      data-mappings:
        communication-direction=OUT, data-element=Swc_SeatSwitch.RootSwCompositionPrototype.P_RcStatus.ECU1_Msg_SH_Sig1, system-signal=SystemSignal_Project_ECU1_Msg_SH_ECU1_Msg_SH_Sig1
        communication-direction=IN, data-element=Swc_SeatSwitch.RootSwCompositionPrototype.R_RcCommand.ECU2_Msg_PD_Sig1, system-signal=SystemSignal_Project_ECU2_Msg_PD_ECU2_Msg_PD_Sig1
    system mapping SwMappings
      sw-mappings:
        swc to ecu mapping SwMapping0: ecu-instance=ECU1
          component:
            RootSwCompositionPrototype.SWC_AppMode
            RootSwCompositionPrototype.SWC_ErrM
            RootSwCompositionPrototype.SWC_TestModeManager
            RootSwCompositionPrototype.SWC_TestModeUser
            RootSwCompositionPrototype.SWC_WdgMTest
            RootSwCompositionPrototype.Swc_SHControl
            RootSwCompositionPrototype.Swc_SeatSwitch
            RootSwCompositionPrototype.Swc_HeatingDial
            RootSwCompositionPrototype.Swc_SeatHeating
            RootSwCompositionPrototype.Svc_IoHwAb
            RootSwCompositionPrototype.BswM
            RootSwCompositionPrototype.ComM
            RootSwCompositionPrototype.Dcm
            RootSwCompositionPrototype.Dem
            RootSwCompositionPrototype.Det
            RootSwCompositionPrototype.EcuM
            RootSwCompositionPrototype.FiM
            RootSwCompositionPrototype.NvM
            RootSwCompositionPrototype.WdgM
    system mapping PncMappings
    root-software-compositions:
      root sw composition prototype RootSwCompositionPrototype: software-composition=EcuComposition
  ecu instance ECU1: associated-com-i-pdu-group=[ISignalIPduGroupRx_ECU1_Project, ISignalIPduGroupTx_ECU1_Project]
    can communication controller ECU1_Project
    can communication connector Conn_ECU1_Project: comm-controller=ECU1_Project
  composition sw component type EcuComposition
    19 x component:
      SWC_AppMode: type=SWC_AppMode
      SWC_ErrM: type=SWC_ErrM
      SWC_TestModeManager: type=SWC_TestModeManager
      SWC_TestModeUser: type=SWC_TestModeUser
      SWC_WdgMTest: type=SWC_WdgMTest
      Swc_SHControl: type=Swc_SHControl
      Swc_SeatSwitch: type=Swc_SeatSwitch
      Swc_HeatingDial: type=Swc_HeatingDial
      Swc_SeatHeating: type=Swc_SeatHeating
      Svc_IoHwAb: type=IoHwAb
      BswM: type=BswM
      ComM: type=ComM
      Dcm: type=Dcm
      Dem: type=Dem
      Det: type=Det
      EcuM: type=EcuM
      FiM: type=FiM
      NvM: type=NvM
      WdgM: type=WdgM
    connect SWC_ErrM.GeneralCBStatusEvt -> Dem.GeneralCBStatusEvt
    connect Swc_SHControl.P_DialLed -> Swc_HeatingDial.R_DialLed
    connect Swc_SeatHeating.P_Heating -> Swc_SHControl.R_HeatingElement
    connect Svc_IoHwAb.P_Led1 -> Swc_HeatingDial.R_IoLed
    connect Svc_IoHwAb.P_Led2 -> Swc_HeatingDial.R_IoAliveLed
    connect Svc_IoHwAb.P_Led4 -> Swc_SeatHeating.R_IoHeating
    connect Svc_IoHwAb.P_Potentiometer -> Swc_HeatingDial.R_IoDial
    connect Swc_SeatSwitch.P_SeatSwitch -> Swc_SHControl.R_SeatSwitch
    connect Swc_SHControl.P_Setting -> Swc_HeatingDial.R_Position
    connect WdgM.WdgM_API_P -> SWC_WdgMTest.WdgM_API_R
    connect WdgM.alive_SE_Init -> SWC_WdgMTest.SE_Init
    connect WdgM.alive_SE_WdgMTest -> SWC_WdgMTest.SE_WdgMTest
    connect WdgM.globalMode -> SWC_WdgMTest.globalMode
    connect SWC_AppMode.modeRequestPort_AppMode -> BswM.modeRequestPort_AppMode
    connect SWC_ErrM.modeRequestPort_AppMode -> BswM.modeRequestPort_AppMode
    connect SWC_AppMode.modeRequestPort_ComMMode_Project -> BswM.modeRequestPort_ComMMode_Project
    connect BswM.modeSwitchPort_ComMMode_Project -> SWC_AppMode.modeNotificationPort_ComMMode_Project
    connect BswM.modeSwitchPort_EcuMode -> SWC_AppMode.modeNotificationPort_EcuMode
    connect BswM.modeSwitchPort_InitState -> SWC_AppMode.modeNotificationPort_InitState
    connect BswM.modeSwitchPort_PduGroupRx_Project -> SWC_AppMode.modeNotificationPort_PduGroupRx_Project
    connect BswM.modeSwitchPort_PduGroupTx_Project -> SWC_AppMode.modeNotificationPort_PduGroupTx_Project
