AUTOSAR XML (schema 4-0-3)
package /Port
  module config Port: implementation-config-variant=VARIANT-POST-BUILD, module-description=BswImplementation_Port
    PortConfigSet_0 (PortConfigSet)
      UnUsedPortPin: PortPinInitialMode=PORT_GPIO_MODE, PortPinWpe=0, PortPinReadback=0, PortPinSafeMode=0, PortPinWps=0, PortPinLevelValue=PORT_PIN_LEVEL_LOW
      8 x PortContainer:
        PortContainer_A: PortNumberOfPortPins=16
          16 x PortPin, all with PortPinOde=0, PortPinSafeMode=0, PortPinReadback=0, PortPinSlewRate=SlowestConfiguration:
            PortContainer_A_PortPin_0: PortPinWpe=0, PortPinWps=0, PortPinDirectionChangeable=1, PortPinModeChangeable=1, PortPinId=1, PortPinPcr=0, PortPinDirection=PORT_PIN_OUT, PortPinInitialMode=PORT_GPIO_MODE, PortPinMode=eMIOS_A0, PortPinLevelValue=PORT_PIN_LEVEL_LOW
            PortContainer_A_PortPin_1: PortPinWpe=1, PortPinWps=1, PortPinDirectionChangeable=1, PortPinModeChangeable=0, PortPinId=2, PortPinPcr=1, PortPinDirection=PORT_PIN_IN, PortPinInitialMode=PORT_GPIO_MODE, PortPinMode=GPIO, PortPinLevelValue=PORT_PIN_LEVEL_LOW
            PortContainer_A_PortPin_2: PortPinWpe=0, PortPinWps=0, PortPinDirectionChangeable=1, PortPinModeChangeable=0, PortPinId=3, PortPinPcr=2, PortPinDirection=PORT_PIN_OUT, PortPinInitialMode=PORT_ALT1_FUNC_MODE, PortPinMode=eMIOS_A2, PortPinLevelValue=PORT_PIN_LEVEL_LOW
            PortContainer_A_PortPin_3: PortPinWpe=0, PortPinWps=0, PortPinDirectionChangeable=1, PortPinModeChangeable=0, PortPinId=4, PortPinPcr=3, PortPinDirection=PORT_PIN_OUT, PortPinInitialMode=PORT_ALT1_FUNC_MODE, PortPinMode=eMIOS_A3, PortPinLevelValue=PORT_PIN_LEVEL_LOW
            PortContainer_A_PortPin_4: PortPinWpe=1, PortPinWps=1, PortPinDirectionChangeable=0, PortPinModeChangeable=0, PortPinId=5, PortPinPcr=4, PortPinDirection=PORT_PIN_OUT, PortPinInitialMode=PORT_ALT1_FUNC_MODE, PortPinMode=eMIOS_A4, PortPinLevelValue=PORT_PIN_LEVEL_LOW
            PortContainer_A_PortPin_5: PortPinWpe=1, PortPinWps=0, PortPinDirectionChangeable=0, PortPinModeChangeable=0, PortPinId=6, PortPinPcr=5, PortPinDirection=PORT_PIN_IN, PortPinInitialMode=PORT_ALT1_FUNC_MODE, PortPinMode=eMIOS_A5, PortPinLevelValue=PORT_PIN_LEVEL_LOW
            PortContainer_A_PortPin_6: PortPinWpe=1, PortPinWps=0, PortPinDirectionChangeable=0, PortPinModeChangeable=0, PortPinId=7, PortPinPcr=6, PortPinDirection=PORT_PIN_IN, PortPinInitialMode=PORT_ALT1_FUNC_MODE, PortPinMode=eMIOS_A6, PortPinLevelValue=PORT_PIN_LEVEL_LOW
            PortContainer_A_PortPin_7: PortPinWpe=1, PortPinWps=0, PortPinDirectionChangeable=0, PortPinModeChangeable=0, PortPinId=8, PortPinPcr=7, PortPinDirection=PORT_PIN_IN, PortPinInitialMode=PORT_ALT1_FUNC_MODE, PortPinMode=eMIOS_A7, PortPinLevelValue=PORT_PIN_LEVEL_LOW
            PortContainer_A_PortPin_8: PortPinWpe=1, PortPinWps=0, PortPinDirectionChangeable=0, PortPinModeChangeable=0, PortPinId=9, PortPinPcr=8, PortPinDirection=PORT_PIN_IN, PortPinInitialMode=PORT_ALT1_FUNC_MODE, PortPinMode=eMIOS_A8, PortPinLevelValue=PORT_PIN_LEVEL_LOW
            PortContainer_A_PortPin_9: PortPinWpe=0, PortPinWps=0, PortPinDirectionChangeable=1, PortPinModeChangeable=1, PortPinId=10, PortPinPcr=9, PortPinDirection=PORT_PIN_OUT, PortPinInitialMode=PORT_ALT1_FUNC_MODE, PortPinMode=eMIOS_A9, PortPinLevelValue=PORT_PIN_LEVEL_LOW
            PortContainer_A_PortPin_10: PortPinWpe=0, PortPinWps=0, PortPinDirectionChangeable=1, PortPinModeChangeable=0, PortPinId=11, PortPinPcr=10, PortPinDirection=PORT_PIN_OUT, PortPinInitialMode=PORT_GPIO_MODE, PortPinMode=GPIO, PortPinLevelValue=PORT_PIN_LEVEL_LOW
            PortContainer_A_PortPin_11: PortPinWpe=0, PortPinWps=0, PortPinDirectionChangeable=1, PortPinModeChangeable=0, PortPinId=12, PortPinPcr=11, PortPinDirection=PORT_PIN_OUT, PortPinInitialMode=PORT_GPIO_MODE, PortPinMode=GPIO, PortPinLevelValue=PORT_PIN_LEVEL_LOW
            PortContainer_A_PortPin_12: PortPinWpe=0, PortPinWps=0, PortPinDirectionChangeable=1, PortPinModeChangeable=0, PortPinId=13, PortPinPcr=12, PortPinDirection=PORT_PIN_IN, PortPinInitialMode=PORT_ONLY_INPUT_MODE, PortPinMode=SPI0_SIN, PortPinLevelValue=PORT_PIN_LEVEL_LOW
            PortContainer_A_PortPin_13: PortPinWpe=0, PortPinWps=0, PortPinDirectionChangeable=1, PortPinModeChangeable=0, PortPinId=14, PortPinPcr=13, PortPinDirection=PORT_PIN_OUT, PortPinInitialMode=PORT_ALT1_FUNC_MODE, PortPinMode=SPI0_SOUT, PortPinLevelValue=PORT_PIN_LEVEL_LOW
            PortContainer_A_PortPin_14: PortPinWpe=0, PortPinWps=0, PortPinDirectionChangeable=1, PortPinModeChangeable=0, PortPinId=15, PortPinPcr=14, PortPinDirection=PORT_PIN_OUT, PortPinInitialMode=PORT_ALT1_FUNC_MODE, PortPinMode=SPI0_SCK, PortPinLevelValue=PORT_PIN_LEVEL_LOW
            PortContainer_A_PortPin_15: PortPinWpe=0, PortPinWps=0, PortPinDirectionChangeable=1, PortPinModeChangeable=0, PortPinId=16, PortPinPcr=15, PortPinDirection=PORT_PIN_OUT, PortPinInitialMode=PORT_GPIO_MODE, PortPinMode=GPIO, PortPinLevelValue=PORT_PIN_LEVEL_HIGH
        PortContainer_B: PortNumberOfPortPins=16
          16 x PortPin, all with PortPinOde=0, PortPinSafeMode=0, PortPinReadback=0, PortPinModeChangeable=0, PortPinLevelValue=PORT_PIN_LEVEL_LOW, PortPinSlewRate=SlowestConfiguration:
            PortContainer_B_PortPin_0: PortPinWpe=1, PortPinWps=1, PortPinDirectionChangeable=1, PortPinId=17, PortPinPcr=16, PortPinDirection=PORT_PIN_OUT, PortPinInitialMode=PORT_GPIO_MODE, PortPinMode=GPIO
            PortContainer_B_PortPin_1: PortPinWpe=1, PortPinWps=1, PortPinDirectionChangeable=1, PortPinId=18, PortPinPcr=17, PortPinDirection=PORT_PIN_IN, PortPinInitialMode=PORT_GPIO_MODE, PortPinMode=GPIO
            PortContainer_B_PortPin_2: PortPinWpe=0, PortPinWps=0, PortPinDirectionChangeable=1, PortPinId=19, PortPinPcr=18, PortPinDirection=PORT_PIN_OUT, PortPinInitialMode=PORT_ALT1_FUNC_MODE, PortPinMode=LIN0_TXD
            PortContainer_B_PortPin_3: PortPinWpe=0, PortPinWps=0, PortPinDirectionChangeable=1, PortPinId=20, PortPinPcr=19, PortPinDirection=PORT_PIN_IN, PortPinInitialMode=PORT_ONLY_INPUT_MODE, PortPinMode=LIN0_RXD
            PortContainer_B_PortPin_4: PortPinWpe=0, PortPinWps=0, PortPinDirectionChangeable=0, PortPinId=21, PortPinPcr=20, PortPinDirection=PORT_PIN_IN, PortPinInitialMode=PORT_ANALOG_INPUT_MODE, PortPinMode=ADCx_ANP0
            PortContainer_B_PortPin_5: PortPinWpe=0, PortPinWps=0, PortPinDirectionChangeable=0, PortPinId=22, PortPinPcr=21, PortPinDirection=PORT_PIN_IN, PortPinInitialMode=PORT_ANALOG_INPUT_MODE, PortPinMode=ADCx_ANP1
            PortContainer_B_PortPin_6: PortPinWpe=0, PortPinWps=0, PortPinDirectionChangeable=1, PortPinId=23, PortPinPcr=22, PortPinDirection=PORT_PIN_IN, PortPinInitialMode=PORT_GPIO_MODE, PortPinMode=GPIO
            PortContainer_B_PortPin_7: PortPinWpe=0, PortPinWps=0, PortPinDirectionChangeable=1, PortPinId=24, PortPinPcr=23, PortPinDirection=PORT_PIN_IN, PortPinInitialMode=PORT_GPIO_MODE, PortPinMode=GPIO
            PortContainer_B_PortPin_8: PortPinWpe=0, PortPinWps=0, PortPinDirectionChangeable=1, PortPinId=25, PortPinPcr=24, PortPinDirection=PORT_PIN_IN, PortPinInitialMode=PORT_GPIO_MODE, PortPinMode=GPIO
            PortContainer_B_PortPin_9: PortPinWpe=0, PortPinWps=0, PortPinDirectionChangeable=1, PortPinId=26, PortPinPcr=25, PortPinDirection=PORT_PIN_IN, PortPinInitialMode=PORT_GPIO_MODE, PortPinMode=GPIO
            PortContainer_B_PortPin_10: PortPinWpe=0, PortPinWps=0, PortPinDirectionChangeable=1, PortPinId=27, PortPinPcr=26, PortPinDirection=PORT_PIN_IN, PortPinInitialMode=PORT_GPIO_MODE, PortPinMode=GPIO
            PortContainer_B_PortPin_11: PortPinWpe=0, PortPinWps=0, PortPinDirectionChangeable=1, PortPinId=28, PortPinPcr=27, PortPinDirection=PORT_PIN_IN, PortPinInitialMode=PORT_GPIO_MODE, PortPinMode=GPIO
            PortContainer_B_PortPin_12: PortPinWpe=0, PortPinWps=0, PortPinDirectionChangeable=1, PortPinId=29, PortPinPcr=28, PortPinDirection=PORT_PIN_IN, PortPinInitialMode=PORT_GPIO_MODE, PortPinMode=GPIO
            PortContainer_B_PortPin_13: PortPinWpe=0, PortPinWps=0, PortPinDirectionChangeable=1, PortPinId=30, PortPinPcr=29, PortPinDirection=PORT_PIN_OUT, PortPinInitialMode=PORT_GPIO_MODE, PortPinMode=GPIO
            PortContainer_B_PortPin_14: PortPinWpe=0, PortPinWps=0, PortPinDirectionChangeable=1, PortPinId=31, PortPinPcr=30, PortPinDirection=PORT_PIN_IN, PortPinInitialMode=PORT_GPIO_MODE, PortPinMode=GPIO
            PortContainer_B_PortPin_15: PortPinWpe=0, PortPinWps=0, PortPinDirectionChangeable=1, PortPinId=32, PortPinPcr=31, PortPinDirection=PORT_PIN_IN, PortPinInitialMode=PORT_GPIO_MODE, PortPinMode=GPIO
        PortContainer_C: PortNumberOfPortPins=16
          16 x PortPin, all with PortPinWpe=0, PortPinWps=0, PortPinOde=0, PortPinSafeMode=0, PortPinReadback=0, PortPinModeChangeable=0, PortPinSlewRate=SlowestConfiguration:
            PortContainer_C_PortPin_0: PortPinDirectionChangeable=0, PortPinId=33, PortPinPcr=32, PortPinDirection=PORT_PIN_IN, PortPinInitialMode=PORT_ALT2_FUNC_MODE, PortPinMode=JTAG_TDI, PortPinLevelValue=PORT_PIN_LEVEL_LOW
            PortContainer_C_PortPin_1: PortPinDirectionChangeable=0, PortPinId=34, PortPinPcr=33, PortPinDirection=PORT_PIN_OUT, PortPinInitialMode=PORT_ALT2_FUNC_MODE, PortPinMode=JTAG_TDO, PortPinLevelValue=PORT_PIN_LEVEL_LOW
            PortContainer_C_PortPin_2: PortPinDirectionChangeable=1, PortPinId=35, PortPinPcr=34, PortPinDirection=PORT_PIN_OUT, PortPinInitialMode=PORT_GPIO_MODE, PortPinMode=GPIO, PortPinLevelValue=PORT_PIN_LEVEL_LOW
            PortContainer_C_PortPin_3: PortPinDirectionChangeable=1, PortPinId=36, PortPinPcr=35, PortPinDirection=PORT_PIN_OUT, PortPinInitialMode=PORT_GPIO_MODE, PortPinMode=GPIO, PortPinLevelValue=PORT_PIN_LEVEL_LOW
            PortContainer_C_PortPin_4: PortPinDirectionChangeable=1, PortPinId=37, PortPinPcr=36, PortPinDirection=PORT_PIN_IN, PortPinInitialMode=PORT_GPIO_MODE, PortPinMode=GPIO, PortPinLevelValue=PORT_PIN_LEVEL_LOW
            PortContainer_C_PortPin_5: PortPinDirectionChangeable=1, PortPinId=38, PortPinPcr=37, PortPinDirection=PORT_PIN_OUT, PortPinInitialMode=PORT_GPIO_MODE, PortPinMode=GPIO, PortPinLevelValue=PORT_PIN_LEVEL_LOW
            PortContainer_C_PortPin_6: PortPinDirectionChangeable=1, PortPinId=39, PortPinPcr=38, PortPinDirection=PORT_PIN_OUT, PortPinInitialMode=PORT_ALT1_FUNC_MODE, PortPinMode=LIN1_TXD, PortPinLevelValue=PORT_PIN_LEVEL_HIGH
            PortContainer_C_PortPin_7: PortPinDirectionChangeable=1, PortPinId=40, PortPinPcr=39, PortPinDirection=PORT_PIN_IN, PortPinInitialMode=PORT_GPIO_MODE, PortPinMode=LIN1_RXD, PortPinLevelValue=PORT_PIN_LEVEL_HIGH
            PortContainer_C_PortPin_8: PortPinDirectionChangeable=1, PortPinId=41, PortPinPcr=40, PortPinDirection=PORT_PIN_OUT, PortPinInitialMode=PORT_GPIO_MODE, PortPinMode=GPIO, PortPinLevelValue=PORT_PIN_LEVEL_LOW
            PortContainer_C_PortPin_9: PortPinDirectionChangeable=1, PortPinId=42, PortPinPcr=41, PortPinDirection=PORT_PIN_OUT, PortPinInitialMode=PORT_GPIO_MODE, PortPinMode=GPIO, PortPinLevelValue=PORT_PIN_LEVEL_LOW
            PortContainer_C_PortPin_10: PortPinDirectionChangeable=1, PortPinId=43, PortPinPcr=42, PortPinDirection=PORT_PIN_OUT, PortPinInitialMode=PORT_ALT1_FUNC_MODE, PortPinMode=CAN1_TX, PortPinLevelValue=PORT_PIN_LEVEL_LOW
            PortContainer_C_PortPin_11: PortPinDirectionChangeable=1, PortPinId=44, PortPinPcr=43, PortPinDirection=PORT_PIN_IN, PortPinInitialMode=PORT_ONLY_INPUT_MODE, PortPinMode=CAN1_RX, PortPinLevelValue=PORT_PIN_LEVEL_LOW
            PortContainer_C_PortPin_12: PortPinDirectionChangeable=1, PortPinId=45, PortPinPcr=44, PortPinDirection=PORT_PIN_IN, PortPinInitialMode=PORT_GPIO_MODE, PortPinMode=GPIO, PortPinLevelValue=PORT_PIN_LEVEL_LOW
            PortContainer_C_PortPin_13: PortPinDirectionChangeable=1, PortPinId=46, PortPinPcr=45, PortPinDirection=PORT_PIN_IN, PortPinInitialMode=PORT_GPIO_MODE, PortPinMode=GPIO, PortPinLevelValue=PORT_PIN_LEVEL_LOW
            PortContainer_C_PortPin_14: PortPinDirectionChangeable=1, PortPinId=47, PortPinPcr=46, PortPinDirection=PORT_PIN_IN, PortPinInitialMode=PORT_GPIO_MODE, PortPinMode=GPIO, PortPinLevelValue=PORT_PIN_LEVEL_LOW
            PortContainer_C_PortPin_15: PortPinDirectionChangeable=1, PortPinId=48, PortPinPcr=47, PortPinDirection=PORT_PIN_IN, PortPinInitialMode=PORT_GPIO_MODE, PortPinMode=GPIO, PortPinLevelValue=PORT_PIN_LEVEL_LOW
        PortContainer_D: PortNumberOfPortPins=16
          16 x PortPin, all with PortPinWpe=0, PortPinWps=0, PortPinOde=0, PortPinSafeMode=0, PortPinDirectionChangeable=1, PortPinReadback=0, PortPinModeChangeable=0, PortPinDirection=PORT_PIN_IN, PortPinInitialMode=PORT_GPIO_MODE, PortPinMode=GPIO, PortPinLevelValue=PORT_PIN_LEVEL_LOW, PortPinSlewRate=SlowestConfiguration:
            PortContainer_D_PortPin_0: PortPinId=49, PortPinPcr=48
            PortContainer_D_PortPin_1: PortPinId=50, PortPinPcr=49
            PortContainer_D_PortPin_2: PortPinId=51, PortPinPcr=50
            PortContainer_D_PortPin_3: PortPinId=52, PortPinPcr=51
            PortContainer_D_PortPin_4: PortPinId=53, PortPinPcr=52
            PortContainer_D_PortPin_5: PortPinId=54, PortPinPcr=53
            PortContainer_D_PortPin_6: PortPinId=55, PortPinPcr=54
            PortContainer_D_PortPin_7: PortPinId=56, PortPinPcr=55
            PortContainer_D_PortPin_8: PortPinId=57, PortPinPcr=56
            PortContainer_D_PortPin_9: PortPinId=58, PortPinPcr=57
            PortContainer_D_PortPin_10: PortPinId=59, PortPinPcr=58
            PortContainer_D_PortPin_11: PortPinId=60, PortPinPcr=59
            PortContainer_D_PortPin_12: PortPinId=61, PortPinPcr=60
            PortContainer_D_PortPin_13: PortPinId=62, PortPinPcr=61
            PortContainer_D_PortPin_14: PortPinId=63, PortPinPcr=62
            PortContainer_D_PortPin_15: PortPinId=64, PortPinPcr=63
        PortContainer_E: PortNumberOfPortPins=16
          16 x PortPin, all with PortPinWpe=0, PortPinWps=0, PortPinOde=0, PortPinSafeMode=0, PortPinDirectionChangeable=1, PortPinReadback=0, PortPinModeChangeable=0, PortPinSlewRate=SlowestConfiguration:
            PortContainer_E_PortPin_0: PortPinId=65, PortPinPcr=64, PortPinDirection=PORT_PIN_IN, PortPinInitialMode=PORT_GPIO_MODE, PortPinMode=GPIO, PortPinLevelValue=PORT_PIN_LEVEL_LOW
            PortContainer_E_PortPin_1: PortPinId=66, PortPinPcr=65, PortPinDirection=PORT_PIN_IN, PortPinInitialMode=PORT_GPIO_MODE, PortPinMode=GPIO, PortPinLevelValue=PORT_PIN_LEVEL_LOW
            PortContainer_E_PortPin_2: PortPinId=67, PortPinPcr=66, PortPinDirection=PORT_PIN_IN, PortPinInitialMode=PORT_GPIO_MODE, PortPinMode=GPIO, PortPinLevelValue=PORT_PIN_LEVEL_LOW
            PortContainer_E_PortPin_3: PortPinId=68, PortPinPcr=67, PortPinDirection=PORT_PIN_IN, PortPinInitialMode=PORT_GPIO_MODE, PortPinMode=GPIO, PortPinLevelValue=PORT_PIN_LEVEL_LOW
            PortContainer_E_PortPin_4: PortPinId=69, PortPinPcr=68, PortPinDirection=PORT_PIN_OUT, PortPinInitialMode=PORT_GPIO_MODE, PortPinMode=GPIO, PortPinLevelValue=PORT_PIN_LEVEL_HIGH
            PortContainer_E_PortPin_5: PortPinId=70, PortPinPcr=69, PortPinDirection=PORT_PIN_OUT, PortPinInitialMode=PORT_GPIO_MODE, PortPinMode=GPIO, PortPinLevelValue=PORT_PIN_LEVEL_HIGH
            PortContainer_E_PortPin_6: PortPinId=71, PortPinPcr=70, PortPinDirection=PORT_PIN_OUT, PortPinInitialMode=PORT_GPIO_MODE, PortPinMode=GPIO, PortPinLevelValue=PORT_PIN_LEVEL_HIGH
            PortContainer_E_PortPin_7: PortPinId=72, PortPinPcr=71, PortPinDirection=PORT_PIN_OUT, PortPinInitialMode=PORT_ALT1_FUNC_MODE, PortPinMode=eMIOS_A23, PortPinLevelValue=PORT_PIN_LEVEL_HIGH
            PortContainer_E_PortPin_8: PortPinId=73, PortPinPcr=72, PortPinDirection=PORT_PIN_IN, PortPinInitialMode=PORT_GPIO_MODE, PortPinMode=GPIO, PortPinLevelValue=PORT_PIN_LEVEL_LOW
            PortContainer_E_PortPin_9: PortPinId=74, PortPinPcr=73, PortPinDirection=PORT_PIN_IN, PortPinInitialMode=PORT_GPIO_MODE, PortPinMode=GPIO, PortPinLevelValue=PORT_PIN_LEVEL_LOW
            PortContainer_E_PortPin_10: PortPinId=75, PortPinPcr=74, PortPinDirection=PORT_PIN_IN, PortPinInitialMode=PORT_GPIO_MODE, PortPinMode=GPIO, PortPinLevelValue=PORT_PIN_LEVEL_LOW
            PortContainer_E_PortPin_11: PortPinId=76, PortPinPcr=75, PortPinDirection=PORT_PIN_IN, PortPinInitialMode=PORT_GPIO_MODE, PortPinMode=GPIO, PortPinLevelValue=PORT_PIN_LEVEL_LOW
            PortContainer_E_PortPin_12: PortPinId=77, PortPinPcr=76, PortPinDirection=PORT_PIN_IN, PortPinInitialMode=PORT_GPIO_MODE, PortPinMode=GPIO, PortPinLevelValue=PORT_PIN_LEVEL_LOW
            PortContainer_E_PortPin_13: PortPinId=78, PortPinPcr=77, PortPinDirection=PORT_PIN_IN, PortPinInitialMode=PORT_GPIO_MODE, PortPinMode=GPIO, PortPinLevelValue=PORT_PIN_LEVEL_LOW
            PortContainer_E_PortPin_14: PortPinId=79, PortPinPcr=78, PortPinDirection=PORT_PIN_IN, PortPinInitialMode=PORT_GPIO_MODE, PortPinMode=GPIO, PortPinLevelValue=PORT_PIN_LEVEL_LOW
            PortContainer_E_PortPin_15: PortPinId=80, PortPinPcr=79, PortPinDirection=PORT_PIN_IN, PortPinInitialMode=PORT_GPIO_MODE, PortPinMode=GPIO, PortPinLevelValue=PORT_PIN_LEVEL_LOW
        PortContainer_F: PortNumberOfPortPins=16
          16 x PortPin, all with PortPinWpe=0, PortPinWps=0, PortPinOde=0, PortPinSafeMode=0, PortPinDirectionChangeable=1, PortPinReadback=0, PortPinModeChangeable=0, PortPinDirection=PORT_PIN_IN, PortPinInitialMode=PORT_GPIO_MODE, PortPinMode=GPIO, PortPinLevelValue=PORT_PIN_LEVEL_LOW, PortPinSlewRate=SlowestConfiguration:
            PortContainer_F_PortPin_0: PortPinId=81, PortPinPcr=80
            PortContainer_F_PortPin_1: PortPinId=82, PortPinPcr=81
            PortContainer_F_PortPin_2: PortPinId=83, PortPinPcr=82
            PortContainer_F_PortPin_3: PortPinId=84, PortPinPcr=83
            PortContainer_F_PortPin_4: PortPinId=85, PortPinPcr=84
            PortContainer_F_PortPin_5: PortPinId=86, PortPinPcr=85
            PortContainer_F_PortPin_6: PortPinId=87, PortPinPcr=86
            PortContainer_F_PortPin_7: PortPinId=88, PortPinPcr=87
            PortContainer_F_PortPin_8: PortPinId=89, PortPinPcr=88
            PortContainer_F_PortPin_9: PortPinId=90, PortPinPcr=89
            PortContainer_F_PortPin_10: PortPinId=91, PortPinPcr=90
            PortContainer_F_PortPin_11: PortPinId=92, PortPinPcr=91
            PortContainer_F_PortPin_12: PortPinId=93, PortPinPcr=92
            PortContainer_F_PortPin_13: PortPinId=94, PortPinPcr=93
            PortContainer_F_PortPin_14: PortPinId=95, PortPinPcr=94
            PortContainer_F_PortPin_15: PortPinId=96, PortPinPcr=95
        PortContainer_G: PortNumberOfPortPins=16
          16 x PortPin, all with PortPinWpe=0, PortPinWps=0, PortPinOde=0, PortPinSafeMode=0, PortPinDirectionChangeable=1, PortPinReadback=0, PortPinModeChangeable=0, PortPinDirection=PORT_PIN_IN, PortPinInitialMode=PORT_GPIO_MODE, PortPinMode=GPIO, PortPinLevelValue=PORT_PIN_LEVEL_LOW, PortPinSlewRate=SlowestConfiguration:
            PortContainer_G_PortPin_0: PortPinId=97, PortPinPcr=96
            PortContainer_G_PortPin_1: PortPinId=98, PortPinPcr=97
            PortContainer_G_PortPin_2: PortPinId=99, PortPinPcr=98
            PortContainer_G_PortPin_3: PortPinId=100, PortPinPcr=99
            PortContainer_G_PortPin_4: PortPinId=101, PortPinPcr=100
            PortContainer_G_PortPin_5: PortPinId=102, PortPinPcr=101
            PortContainer_G_PortPin_6: PortPinId=103, PortPinPcr=102
            PortContainer_G_PortPin_7: PortPinId=104, PortPinPcr=103
            PortContainer_G_PortPin_8: PortPinId=105, PortPinPcr=104
            PortContainer_G_PortPin_9: PortPinId=106, PortPinPcr=105
            PortContainer_G_PortPin_10: PortPinId=107, PortPinPcr=106
            PortContainer_G_PortPin_11: PortPinId=108, PortPinPcr=107
            PortContainer_G_PortPin_12: PortPinId=109, PortPinPcr=108
            PortContainer_G_PortPin_13: PortPinId=110, PortPinPcr=109
            PortContainer_G_PortPin_14: PortPinId=111, PortPinPcr=110
            PortContainer_G_PortPin_15: PortPinId=112, PortPinPcr=111
        PortContainer_H: PortNumberOfPortPins=11
          11 x PortPin, all with PortPinWpe=0, PortPinWps=0, PortPinOde=0, PortPinSafeMode=0, PortPinReadback=0, PortPinModeChangeable=0, PortPinLevelValue=PORT_PIN_LEVEL_LOW, PortPinSlewRate=SlowestConfiguration:
            PortContainer_H_PortPin_0: PortPinDirectionChangeable=0, PortPinId=113, PortPinPcr=112, PortPinDirection=PORT_PIN_IN, PortPinInitialMode=PORT_ONLY_INPUT_MODE, PortPinMode=SPI1_SIN
            PortContainer_H_PortPin_1: PortPinDirectionChangeable=0, PortPinId=114, PortPinPcr=113, PortPinDirection=PORT_PIN_OUT, PortPinInitialMode=PORT_ALT2_FUNC_MODE, PortPinMode=SPI1_SOUT
            PortContainer_H_PortPin_2: PortPinDirectionChangeable=0, PortPinId=115, PortPinPcr=114, PortPinDirection=PORT_PIN_OUT, PortPinInitialMode=PORT_ALT2_FUNC_MODE, PortPinMode=SPI1_SCK
            PortContainer_H_PortPin_3: PortPinDirectionChangeable=0, PortPinId=116, PortPinPcr=115, PortPinDirection=PORT_PIN_IN, PortPinInitialMode=PORT_ALT2_FUNC_MODE, PortPinMode=SPI1_CS0
            PortContainer_H_PortPin_4: PortPinDirectionChangeable=1, PortPinId=117, PortPinPcr=116, PortPinDirection=PORT_PIN_IN, PortPinInitialMode=PORT_GPIO_MODE, PortPinMode=GPIO
            PortContainer_H_PortPin_5: PortPinDirectionChangeable=1, PortPinId=118, PortPinPcr=117, PortPinDirection=PORT_PIN_IN, PortPinInitialMode=PORT_GPIO_MODE, PortPinMode=GPIO
            PortContainer_H_PortPin_6: PortPinDirectionChangeable=1, PortPinId=119, PortPinPcr=118, PortPinDirection=PORT_PIN_IN, PortPinInitialMode=PORT_GPIO_MODE, PortPinMode=GPIO
            PortContainer_H_PortPin_7: PortPinDirectionChangeable=1, PortPinId=120, PortPinPcr=119, PortPinDirection=PORT_PIN_IN, PortPinInitialMode=PORT_GPIO_MODE, PortPinMode=GPIO
            PortContainer_H_PortPin_8: PortPinDirectionChangeable=1, PortPinId=121, PortPinPcr=120, PortPinDirection=PORT_PIN_IN, PortPinInitialMode=PORT_GPIO_MODE, PortPinMode=GPIO
            PortContainer_H_PortPin_9: PortPinDirectionChangeable=1, PortPinId=122, PortPinPcr=121, PortPinDirection=PORT_PIN_IN, PortPinInitialMode=PORT_ALT2_FUNC_MODE, PortPinMode=JTAG_TCK
            PortContainer_H_PortPin_10: PortPinDirectionChangeable=1, PortPinId=123, PortPinPcr=122, PortPinDirection=PORT_PIN_IN, PortPinInitialMode=PORT_ALT2_FUNC_MODE, PortPinMode=JTAG_TMS
    PortGeneral: PortDevErrorDetect=1, PortSetPinDirectionApi=1, PortSetPinModeApi=0, PortVersionInfoApi=0, PortPinAbstractedMode=0
    CommonPublishedInformation:
      ArReleaseMajorVersion = 4
      ArReleaseMinorVersion = 0
      ArReleaseRevisionVersion = 3
      ModuleId = 124
      SwMajorVersion = 1
      SwMinorVersion = 0
      SwPatchVersion = 1
      VendorId = 43
