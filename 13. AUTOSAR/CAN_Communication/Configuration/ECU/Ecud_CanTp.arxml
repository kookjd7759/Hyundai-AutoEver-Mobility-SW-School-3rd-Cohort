AUTOSAR XML (schema 4-0-3)
package /AUTOSAR
  module config CanTp: implementation-config-variant=VARIANT-PRE-COMPILE, module-description=BswImplementation_CanTp
    CanTpConfig: CanTpMainFunctionPeriod=0.005
      4 x CanTpChannel, all with category=TOOL_CONFIGURED, CanTpChannelMode=CANTP_MODE_HALF_DUPLEX:
        CanTpChannel_0_Pdu_ISignalIPdu_Project_GST_Msg_TP1
          CanTpRxNSdu_0_Pdu_ISignalIPdu_Project_GST_Msg_TP1 (CanTpRxNSdu):
            category = TOOL_CONFIGURED
            CanTpRxPaddingActivation = CANTP_ON
            CanTpRxAddressingFormat = CANTP_STANDARD
            CanTpRxTaType = CANTP_PHYSICAL
            CanTpRxNSduId = 0
            CanTpRxDl = 1
            CanTpNbr = 0
            CanTpBs = 0
            CanTpNcr = 1
            CanTpNar = 1
            CanTpRxWftMax = 0
            CanTpSTmin = 0.005
            CanTpRxNSduRef = Pdu_ISignalIPdu_Project_GST_Msg_TP1
            CanTpTxFcNPdu_0 (CanTpTxFcNPdu): category=TOOL_CONFIGURED, CanTpTxFcNPduConfirmationPduId=0, CanTpTxFcNPduRef=Pdu_NPdu_Project_ECU1_Msg_TP1
            CanTpRxNPdu_0 (CanTpRxNPdu): category=TOOL_CONFIGURED, CanTpRxNPduId=0, CanTpRxNPduRef=Pdu_NPdu_Project_GST_Msg_TP1
            CanTpNSa_0 (CanTpNSa): category=TOOL_CONFIGURED, CanTpNSa=8
            CanTpNTa_0 (CanTpNTa): category=TOOL_CONFIGURED, CanTpNTa=240
          CanTpTxNSdu_0_Pdu_ISignalIPdu_Project_ECU1_Msg_TP1 (CanTpTxNSdu):
            category = TOOL_CONFIGURED
            CanTpTxAddressingFormat = CANTP_STANDARD
            CanTpTxPaddingActivation = CANTP_ON
            CanTpTxDl = 1
            CanTpTxNSduId = 0
            CanTpTc = 1
            CanTpTxTaType = CANTP_PHYSICAL
            CanTpNbs = 1
            CanTpNas = 1
            CanTpNcs = 0
            CanTpTxNSduRef = Pdu_ISignalIPdu_Project_ECU1_Msg_TP1
            CanTpTxNPdu_0 (CanTpTxNPdu): category=TOOL_CONFIGURED, CanTpTxNPduConfirmationPduId=0, CanTpTxNPduRef=Pdu_NPdu_Project_ECU1_Msg_TP1
            CanTpRxFcNPdu_0 (CanTpRxFcNPdu): category=TOOL_CONFIGURED, CanTpRxFcNPduId=0, CanTpRxFcNPduRef=Pdu_NPdu_Project_GST_Msg_TP1
            CanTpNSa_0 (CanTpNSa): category=TOOL_CONFIGURED, CanTpNSa=8
            CanTpNTa_0 (CanTpNTa): category=TOOL_CONFIGURED, CanTpNTa=240
        CanTpChannel_1_Pdu_ISignalIPdu_Project_GST_Msg_TP2
          CanTpRxNSdu_1_Pdu_ISignalIPdu_Project_GST_Msg_TP2 (CanTpRxNSdu):
            category = TOOL_CONFIGURED
            CanTpRxPaddingActivation = CANTP_ON
            CanTpRxAddressingFormat = CANTP_STANDARD
            CanTpRxTaType = CANTP_PHYSICAL
            CanTpRxNSduId = 1
            CanTpRxDl = 1
            CanTpRxWftMax = 0
            CanTpNar = 1
            CanTpNcr = 1
            CanTpBs = 0
            CanTpNbr = 0
            CanTpSTmin = 0.005
            CanTpRxNSduRef = Pdu_ISignalIPdu_Project_GST_Msg_TP2
            CanTpTxFcNPdu_1 (CanTpTxFcNPdu): category=TOOL_CONFIGURED, CanTpTxFcNPduConfirmationPduId=1, CanTpTxFcNPduRef=Pdu_NPdu_Project_ECU1_Msg_TP2
            CanTpRxNPdu_1 (CanTpRxNPdu): category=TOOL_CONFIGURED, CanTpRxNPduId=1, CanTpRxNPduRef=Pdu_NPdu_Project_GST_Msg_TP2
            CanTpNSa_1 (CanTpNSa): category=TOOL_CONFIGURED, CanTpNSa=8
            CanTpNTa_1 (CanTpNTa): category=TOOL_CONFIGURED, CanTpNTa=240
          CanTpTxNSdu_1_Pdu_ISignalIPdu_Project_ECU1_Msg_TP2 (CanTpTxNSdu):
            category = TOOL_CONFIGURED
            CanTpTxAddressingFormat = CANTP_STANDARD
            CanTpTxPaddingActivation = CANTP_ON
            CanTpTxDl = 1
            CanTpTxNSduId = 1
            CanTpTc = 1
            CanTpTxTaType = CANTP_PHYSICAL
            CanTpNcs = 0
            CanTpNbs = 1
            CanTpNas = 1
            CanTpTxNSduRef = Pdu_ISignalIPdu_Project_ECU1_Msg_TP2
            CanTpTxNPdu_1 (CanTpTxNPdu): category=TOOL_CONFIGURED, CanTpTxNPduConfirmationPduId=1, CanTpTxNPduRef=Pdu_NPdu_Project_ECU1_Msg_TP2
            CanTpRxFcNPdu_1 (CanTpRxFcNPdu): category=TOOL_CONFIGURED, CanTpRxFcNPduId=1, CanTpRxFcNPduRef=Pdu_NPdu_Project_GST_Msg_TP2
            CanTpNSa_1 (CanTpNSa): category=TOOL_CONFIGURED, CanTpNSa=8
            CanTpNTa_1 (CanTpNTa): category=TOOL_CONFIGURED, CanTpNTa=240
        CanTpChannel_2_Pdu_DcmIPdu_Project_GST_Msg_TP_Phys
          CanTpTxNSdu_2_Pdu_DcmIPdu_Project_ECU1_GST_Msg_TP (CanTpTxNSdu):
            category = TOOL_CONFIGURED
            CanTpTxAddressingFormat = CANTP_STANDARD
            CanTpTxPaddingActivation = CANTP_ON
            CanTpTxDl = 1
            CanTpTxNSduId = 2
            CanTpTc = 1
            CanTpTxTaType = CANTP_PHYSICAL
            CanTpNbs = 1
            CanTpNas = 1
            CanTpNcs = 0
            CanTpTxNSduRef = Pdu_DcmIPdu_Project_ECU1_GST_Msg_TP
            CanTpTxNPdu_2 (CanTpTxNPdu): category=TOOL_CONFIGURED, CanTpTxNPduConfirmationPduId=2, CanTpTxNPduRef=Pdu_NPdu_Project_ECU1_GST_Msg_TP
            CanTpRxFcNPdu_2 (CanTpRxFcNPdu): category=TOOL_CONFIGURED, CanTpRxFcNPduId=2, CanTpRxFcNPduRef=Pdu_NPdu_Project_GST_Msg_TP_Phys
            CanTpNSa_2 (CanTpNSa): category=TOOL_CONFIGURED, CanTpNSa=8
            CanTpNTa_2 (CanTpNTa): category=TOOL_CONFIGURED, CanTpNTa=240
          CanTpRxNSdu_2_Pdu_DcmIPdu_Project_GST_Msg_TP_Phys (CanTpRxNSdu):
            category = TOOL_CONFIGURED
            CanTpRxPaddingActivation = CANTP_ON
            CanTpRxAddressingFormat = CANTP_STANDARD
            CanTpRxTaType = CANTP_PHYSICAL
            CanTpRxNSduId = 2
            CanTpRxDl = 1
            CanTpNar = 1
            CanTpNbr = 0
            CanTpNcr = 1
            CanTpBs = 0
            CanTpRxWftMax = 0
            CanTpSTmin = 0.005
            CanTpRxNSduRef = Pdu_DcmIPdu_Project_GST_Msg_TP_Phys
            CanTpTxFcNPdu_2 (CanTpTxFcNPdu): category=TOOL_CONFIGURED, CanTpTxFcNPduConfirmationPduId=2, CanTpTxFcNPduRef=Pdu_NPdu_Project_ECU1_GST_Msg_TP
            CanTpRxNPdu_2 (CanTpRxNPdu): category=TOOL_CONFIGURED, CanTpRxNPduId=2, CanTpRxNPduRef=Pdu_NPdu_Project_GST_Msg_TP_Phys
            CanTpNSa_2 (CanTpNSa): category=TOOL_CONFIGURED, CanTpNSa=8
            CanTpNTa_2 (CanTpNTa): category=TOOL_CONFIGURED, CanTpNTa=240
        CanTpChannel_3_RxOnly_Pdu_DcmIPdu_Project_GST_Msg_TP_Func
          CanTpRxNSdu_3_Pdu_DcmIPdu_Project_GST_Msg_TP_Func (CanTpRxNSdu):
            category = TOOL_CONFIGURED
            CanTpRxPaddingActivation = CANTP_ON
            CanTpRxAddressingFormat = CANTP_STANDARD
            CanTpRxTaType = CANTP_FUNCTIONAL
            CanTpRxNSduId = 3
            CanTpRxDl = 1
            CanTpSTmin = 0.005
            CanTpRxWftMax = 0
            CanTpNar = 1
            CanTpBs = 0
            CanTpNcr = 1
            CanTpNbr = 0
            CanTpRxNSduRef = Pdu_DcmIPdu_Project_GST_Msg_TP_Func
            CanTpRxNPdu_3 (CanTpRxNPdu): category=TOOL_CONFIGURED, CanTpRxNPduId=3, CanTpRxNPduRef=Pdu_NPdu_Project_GST_Msg_TP_Func
            CanTpNSa_3 (CanTpNSa): category=TOOL_CONFIGURED, CanTpNSa=8
            CanTpNTa_3 (CanTpNTa): category=TOOL_CONFIGURED, CanTpNTa=240
    CanTpGeneral0 (CanTpGeneral): CanTpChangeParameterApi=1, CanTpDevErrorDetect=1, CanTpPaddingByte=0xAA, CanTpReadParameterApi=0, CanTpVersionInfoApi=0
