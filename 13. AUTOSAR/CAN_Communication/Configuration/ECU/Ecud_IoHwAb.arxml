AUTOSAR XML (schema 4-0-3)
package /AUTOSAR
  module config IoHwAb: implementation-config-variant=VARIANT-PRE-COMPILE, module-description=BswImplementation_IoHwAb
    IoHwAbGeneral: IoHwAbDevErrorDetect=1, IoHwAbVersionInfoApi=0, IoHwAbMcalVendorVersion=FREESCALE_MPC560XB_101HF5
      IoHwAbPortPinChs
        PortE_Ch4 (IoHwAbPortPinCh): IoHwAbPolarity=HighActive, IoHwAbHwDioChRef=DioPort_E_DioChannel_4, IoHwAbHwPortPinRef=PortContainer_E_PortPin_4
        PortE_Ch5 (IoHwAbPortPinCh): IoHwAbPolarity=HighActive, IoHwAbHwDioChRef=DioPort_E_DioChannel_5, IoHwAbHwPortPinRef=PortContainer_E_PortPin_5
      IoHwAbAdcSetting: IoHwAbAdcReadDirectMaxDelay=0xFFFF
        IoHwAbAdcGroups
          IoHwAbAdcGroup_0 (IoHwAbAdcGroup): IoHwAbHwAdcGroupRef=AdcGroup_0
        IoHwAbAdcAllGroups: IoHwAbHwAdcAllGroupRef=AdcAllGroup0
          IoHwAbAdcGroupInAll: IoHwAbHwAdcGroupRef=AdcGroup_4
    IoHwAbConfig:
      IoHwAbUseLowPowerFlag = 0
      IoHwAbUseAnalogInputDirect = 1
      IoHwAbUsePwm = 1
      IoHwAbUseGpt = 1
      IoHwAbUseIcu = 1
      IoHwAbUseOcu = 0
      IoHwAbUseIOManager = 1
      IoHwAbUseDigitalDirect = 1
      IoHwAbDigitalDirect
        Led1 (IoHwAbDigitalDirectLogical): IoHwAbPortPinChRef=PortE_Ch4
        Led2 (IoHwAbDigitalDirectLogical): IoHwAbPortPinChRef=PortE_Ch5
      IoHwAbAnalogInputDirect
        Potentiometer (IoHwAbAnalogInputDirectLogical): IoHwAbAdcGroupRef=IoHwAbAdcGroup_0
      IoHwAbPwm
        IoHwAbPwm_0 (IoHwAbPwmLogical): IoHwAbPwmCallbackViaRte=0, IoHwAbHwPwmChRef=PwmChannel_0
        Led4 (IoHwAbPwmLogical): IoHwAbPwmCallbackViaRte=0, IoHwAbHwPwmChRef=PwmChannel_Led4
      IoHwAbGpt
        IoHwAbGptLogical0 (IoHwAbGptLogical): IoHwAbGptCallbackViaRte=1, IoHwAbHwGptChRef=GptChannelConfiguration_IoManager
      IoHwAbIcu
        IoHwAbIcuLogical_Timestamp_PA8 (IoHwAbIcuLogical): IoHwAbIcuCallbackViaRte=1, IoHwAbHwIcuChRef=IcuChannel_Timestamp
      IoHwAbIOManager:
        IoHwAbUseAnalogInput = 1
        IoHwAbUseDigitalInput = 0
        IoHwAbUseDigitalOutput = 0
        IoHwAbUseInputSupplySwitch = 0
        IoHwAbUseVoltageMonitoring = 0
        IoHwAbMultipleActivationDelay = 200
        IoHwAbTaskFG1Ref = OsTask_BSW_FG1_IOManager
        IoHwAbTaskFG2Ref = OsTask_BSW_FG2_IOManager
        IoHwAbIOMTimer: IoHwAbGptChRef=GptChannelConfiguration_IoManager
        IoHwAbAnalogInput
          IoHwAbAnalogInputLogical_PD00 (IoHwAbAnalogInputLogical): IoHwAbDirectAccess=1, IoHwAbDefaultValue=0, IoHwAbFilterConstant=0, IoHwAbAdcGroupRef=IoHwAbAdcGroupInAll
