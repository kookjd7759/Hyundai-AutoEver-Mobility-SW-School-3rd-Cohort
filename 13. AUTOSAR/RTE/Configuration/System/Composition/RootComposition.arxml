AUTOSAR XML (schema 4-0-3)
package /AUTOSAR
  composition sw component type CSWC_RootCompostion
    8 x component:
      SWC_WdgMTest: type=SWC_WdgMTest
      SWC_ErrM: type=SWC_ErrM
      SWC_AppMode: type=SWC_AppMode
      SWC_TestModeUser: type=SWC_TestModeUser
      SWC_TestModeManager: type=SWC_TestModeManager
      Swc_SeatHeating: type=Swc_SeatHeating
      Swc_SHControl: type=Swc_SHControl
      Swc_HeatingDial: type=Swc_HeatingDial
    connect Swc_SHControl.P_DialLed -> Swc_HeatingDial.R_DialLed
    connect Swc_SeatHeating.P_Heating -> Swc_SHControl.R_HeatingElement
    connect Swc_SHControl.P_Setting -> Swc_HeatingDial.R_Position
