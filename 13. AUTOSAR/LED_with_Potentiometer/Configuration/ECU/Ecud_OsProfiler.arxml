AUTOSAR XML (schema 4-0-3)
package /AUTRON
  module config OsProfiler: implementation-config-variant=VARIANT-PRE-COMPILE, module-description=BswImplementation_OsProfiler
    OsProfilerGlobalConfig: EnableOsProfiler=0, EnableProfileIsr=0, ProfileEventCount=20, EnableTimeIndex=0, TimeIndexPeriod=0.005
    OsProfilerTargetConfig: TargetOperatingSystem=FREESCALE_MPC560xB, XOSC=8
