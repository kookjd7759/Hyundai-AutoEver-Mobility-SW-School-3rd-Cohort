AUTOSAR XML (schema 4-0-3)
package /AUTOSAR
  module config Com: implementation-config-variant=VARIANT-PRE-COMPILE, module-description=BswImplementation_Com
    ComConfig: ComConfigurationId=0
      19 x ComIPdu, all with category=TOOL_CONFIGURED, ComIPduSignalProcessing=DEFERRED:
        ComIPdu_ECU1_Msg_GW1: ComIPduDirection=SEND, ComIPduHandleId=3, ComIPduType=NORMAL, ComPduIdRef=Pdu_ISignalIPdu_ECU1_Msg_GW1, ComIPduGroupRef=ComIPduGroupTx_ECU1_Project, ComIPduSignalRef=ComISignal_ECU1_Msg_GW1_ECU1_Msg_GW1_Sig2, ComIPduSignalRef=ComISignal_ECU1_Msg_GW1_ECU1_Msg_GW1_Sig1
          ComTxIpdu_ComIPdu_ECU1_Msg_GW1 (ComTxIPdu): category=TOOL_CONFIGURED, ComMinimumDelayTime=0.02, ComTxIPduUnusedAreasDefault=0
            ComTxModeTrue_ComTxIpdu_ComIPdu_ECU1_Msg_GW1 (ComTxModeTrue): category=TOOL_CONFIGURED
              ComTxMode_ComTxModeTrue_ComTxIpdu_ComIPdu_ECU1_Msg_GW1 (ComTxMode): category=TOOL_CONFIGURED, ComTxModeMode=DIRECT, ComTxModeNumberOfRepetitions=3, ComTxModeRepetitionPeriod=0.04
        ComIPdu_ECU1_Msg_IF1: ComIPduDirection=SEND, ComIPduHandleId=2, ComIPduType=NORMAL, ComPduIdRef=Pdu_ISignalIPdu_ECU1_Msg_IF1, ComIPduGroupRef=ComIPduGroupTx_ECU1_Project, ComIPduSignalRef=ComISignal_ECU1_Msg_IF1_ECU1_Msg_IF1_Sig2, ComIPduSignalRef=ComISignal_ECU1_Msg_IF1_ECU1_Msg_IF1_Sig1
          ComTxIpdu_ComIPdu_ECU1_Msg_IF1 (ComTxIPdu): category=TOOL_CONFIGURED, ComMinimumDelayTime=0.02, ComTxIPduUnusedAreasDefault=0
            ComTxModeTrue_ComTxIpdu_ComIPdu_ECU1_Msg_IF1 (ComTxModeTrue): category=TOOL_CONFIGURED
              ComTxMode_ComTxModeTrue_ComTxIpdu_ComIPdu_ECU1_Msg_IF1 (ComTxMode): category=TOOL_CONFIGURED, ComTxModeMode=DIRECT, ComTxModeNumberOfRepetitions=3, ComTxModeRepetitionPeriod=0.2
        ComIPdu_ECU1_Msg_OE1: ComIPduDirection=SEND, ComIPduHandleId=4, ComIPduType=NORMAL, ComPduIdRef=Pdu_ISignalIPdu_ECU1_Msg_OE1, ComIPduGroupRef=ComIPduGroupTx_ECU1_Project, ComIPduSignalRef=ComISignal_ECU1_Msg_OE1_ECU1_Msg_OE1_Sig1, ComIPduSignalRef=ComISignal_ECU1_Msg_OE1_ECU1_Msg_OE1_Sig2, ComIPduSignalRef=ComISignal_ECU1_Msg_OE1_ECU1_Msg_OE1_Sig3, ComIPduSignalRef=ComISignal_ECU1_Msg_OE1_ECU1_Msg_OE1_Sig4, ComIPduSignalRef=ComISignal_ECU1_Msg_OE1_ECU1_Msg_OE1_Sig5
          ComTxIpdu_ComIPdu_ECU1_Msg_OE1 (ComTxIPdu): category=TOOL_CONFIGURED, ComMinimumDelayTime=0.02, ComTxIPduUnusedAreasDefault=0
            ComTxModeTrue_ComTxIpdu_ComIPdu_ECU1_Msg_OE1 (ComTxModeTrue): category=TOOL_CONFIGURED
              ComTxMode_ComTxModeTrue_ComTxIpdu_ComIPdu_ECU1_Msg_OE1 (ComTxMode): category=TOOL_CONFIGURED, ComTxModeMode=DIRECT, ComTxModeNumberOfRepetitions=3, ComTxModeRepetitionPeriod=0.04
        ComIPdu_ECU1_Msg_P1: ComIPduDirection=SEND, ComIPduHandleId=5, ComIPduType=NORMAL, ComPduIdRef=Pdu_ISignalIPdu_ECU1_Msg_P1, ComIPduGroupRef=ComIPduGroupTx_ECU1_Project, ComIPduSignalRef=ComISignal_ECU1_Msg_P1_ECU1_Msg_P1_Sig2, ComIPduSignalRef=ComISignal_ECU1_Msg_P1_ECU1_Msg_P1_Sig1
          ComTxIpdu_ComIPdu_ECU1_Msg_P1 (ComTxIPdu): category=TOOL_CONFIGURED, ComMinimumDelayTime=0.02, ComTxIPduUnusedAreasDefault=0
            ComTxModeTrue_ComTxIpdu_ComIPdu_ECU1_Msg_P1 (ComTxModeTrue): category=TOOL_CONFIGURED
              ComTxMode_ComTxModeTrue_ComTxIpdu_ComIPdu_ECU1_Msg_P1 (ComTxMode): category=TOOL_CONFIGURED, ComTxModeMode=PERIODIC, ComTxModeTimeOffset=0.0, ComTxModeTimePeriod=0.5
        ComIPdu_ECU1_Msg_P2: ComIPduDirection=SEND, ComIPduHandleId=9, ComIPduType=NORMAL, ComPduIdRef=Pdu_ISignalIPdu_ECU1_Msg_P2, ComIPduGroupRef=ComIPduGroupTx_ECU1_Project, ComIPduSignalRef=ComISignal_ECU1_Msg_P2_ECU1_Msg_P2_Sig2, ComIPduSignalRef=ComISignal_ECU1_Msg_P2_ECU1_Msg_P2_Sig1
          ComTxIpdu_ComIPdu_ECU1_Msg_P2 (ComTxIPdu): category=TOOL_CONFIGURED, ComMinimumDelayTime=0.02, ComTxIPduUnusedAreasDefault=0
            ComTxModeTrue_ComTxIpdu_ComIPdu_ECU1_Msg_P2 (ComTxModeTrue): category=TOOL_CONFIGURED
              ComTxMode_ComTxModeTrue_ComTxIpdu_ComIPdu_ECU1_Msg_P2 (ComTxMode): category=TOOL_CONFIGURED, ComTxModeMode=PERIODIC, ComTxModeTimeOffset=0.0, ComTxModeTimePeriod=0.2
        ComIPdu_ECU1_Msg_P3: ComIPduDirection=SEND, ComIPduHandleId=8, ComIPduType=NORMAL, ComPduIdRef=Pdu_ISignalIPdu_ECU1_Msg_P3, ComIPduGroupRef=ComIPduGroupTx_ECU1_Project, ComIPduSignalRef=ComISignal_ECU1_Msg_P3_ECU1_Msg_P3_Sig2, ComIPduSignalRef=ComISignal_ECU1_Msg_P3_ECU1_Msg_P3_Sig1
          ComTxIpdu_ComIPdu_ECU1_Msg_P3 (ComTxIPdu): category=TOOL_CONFIGURED, ComMinimumDelayTime=0.02, ComTxIPduUnusedAreasDefault=0
            ComTxModeTrue_ComTxIpdu_ComIPdu_ECU1_Msg_P3 (ComTxModeTrue): category=TOOL_CONFIGURED
              ComTxMode_ComTxModeTrue_ComTxIpdu_ComIPdu_ECU1_Msg_P3 (ComTxMode): category=TOOL_CONFIGURED, ComTxModeMode=PERIODIC, ComTxModeTimeOffset=0.0, ComTxModeTimePeriod=0.2
        ComIPdu_ECU1_Msg_P4: ComIPduDirection=SEND, ComIPduHandleId=7, ComIPduType=NORMAL, ComPduIdRef=Pdu_ISignalIPdu_ECU1_Msg_P4, ComIPduGroupRef=ComIPduGroupTx_ECU1_Project, ComIPduSignalRef=ComISignal_ECU1_Msg_P4_ECU1_Msg_P4_Sig2, ComIPduSignalRef=ComISignal_ECU1_Msg_P4_ECU1_Msg_P4_Sig1
          ComTxIpdu_ComIPdu_ECU1_Msg_P4 (ComTxIPdu): category=TOOL_CONFIGURED, ComMinimumDelayTime=0.02, ComTxIPduUnusedAreasDefault=0
            ComTxModeTrue_ComTxIpdu_ComIPdu_ECU1_Msg_P4 (ComTxModeTrue): category=TOOL_CONFIGURED
              ComTxMode_ComTxModeTrue_ComTxIpdu_ComIPdu_ECU1_Msg_P4 (ComTxMode): category=TOOL_CONFIGURED, ComTxModeMode=PERIODIC, ComTxModeTimeOffset=0.0, ComTxModeTimePeriod=0.2
        ComIPdu_ECU1_Msg_PIF1: ComIPduDirection=SEND, ComIPduHandleId=6, ComIPduType=NORMAL, ComPduIdRef=Pdu_ISignalIPdu_ECU1_Msg_PIF1, ComIPduGroupRef=ComIPduGroupTx_ECU1_Project, ComIPduSignalRef=ComISignal_ECU1_Msg_PIF1_ECU1_Msg_PIF1_Sig2, ComIPduSignalRef=ComISignal_ECU1_Msg_PIF1_ECU1_Msg_PIF1_Sig1
          ComTxIpdu_ComIPdu_ECU1_Msg_PIF1 (ComTxIPdu): category=TOOL_CONFIGURED, ComMinimumDelayTime=0.02, ComTxIPduUnusedAreasDefault=0
            ComTxModeTrue_ComTxIpdu_ComIPdu_ECU1_Msg_PIF1 (ComTxModeTrue): category=TOOL_CONFIGURED
              ComTxMode_ComTxModeTrue_ComTxIpdu_ComIPdu_ECU1_Msg_PIF1 (ComTxMode):
                category = TOOL_CONFIGURED
                ComTxModeMode = MIXED
                ComTxModeNumberOfRepetitions = 3
                ComTxModeRepetitionPeriod = 0.2
                ComTxModeTimeOffset = 0.0
                ComTxModeTimePeriod = 0.5
        ComIPdu_ECU1_Msg_POE1: ComIPduDirection=SEND, ComIPduHandleId=11, ComIPduType=NORMAL, ComPduIdRef=Pdu_ISignalIPdu_ECU1_Msg_POE1, ComIPduGroupRef=ComIPduGroupTx_ECU1_Project, ComIPduSignalRef=ComISignal_ECU1_Msg_POE1_ECU1_Msg_POE1_Sig2, ComIPduSignalRef=ComISignal_ECU1_Msg_POE1_ECU1_Msg_POE1_Sig1
          ComTxIpdu_ComIPdu_ECU1_Msg_POE1 (ComTxIPdu): category=TOOL_CONFIGURED, ComMinimumDelayTime=0.02, ComTxIPduUnusedAreasDefault=0
            ComTxModeTrue_ComTxIpdu_ComIPdu_ECU1_Msg_POE1 (ComTxModeTrue): category=TOOL_CONFIGURED
              ComTxMode_ComTxModeTrue_ComTxIpdu_ComIPdu_ECU1_Msg_POE1 (ComTxMode):
                category = TOOL_CONFIGURED
                ComTxModeMode = MIXED
                ComTxModeNumberOfRepetitions = 3
                ComTxModeRepetitionPeriod = 0.04
                ComTxModeTimeOffset = 0.0
                ComTxModeTimePeriod = 0.2
        ComIPdu_ECU1_Msg_POE2: ComIPduDirection=SEND, ComIPduHandleId=10, ComIPduType=NORMAL, ComPduIdRef=Pdu_ISignalIPdu_ECU1_Msg_POE2, ComIPduGroupRef=ComIPduGroupTx_ECU1_Project, ComIPduSignalRef=ComISignal_ECU1_Msg_POE2_ECU1_Msg_POE2_Sig2, ComIPduSignalRef=ComISignal_ECU1_Msg_POE2_ECU1_Msg_POE2_Sig1
          ComTxIpdu_ComIPdu_ECU1_Msg_POE2 (ComTxIPdu): category=TOOL_CONFIGURED, ComMinimumDelayTime=0.02, ComTxIPduUnusedAreasDefault=0
            ComTxModeTrue_ComTxIpdu_ComIPdu_ECU1_Msg_POE2 (ComTxModeTrue): category=TOOL_CONFIGURED
              ComTxMode_ComTxModeTrue_ComTxIpdu_ComIPdu_ECU1_Msg_POE2 (ComTxMode):
                category = TOOL_CONFIGURED
                ComTxModeMode = MIXED
                ComTxModeNumberOfRepetitions = 3
                ComTxModeRepetitionPeriod = 0.04
                ComTxModeTimeOffset = 0.0
                ComTxModeTimePeriod = 0.2
        ComIPdu_ECU1_Msg_POE3: ComIPduDirection=SEND, ComIPduHandleId=12, ComIPduType=NORMAL, ComPduIdRef=Pdu_ISignalIPdu_ECU1_Msg_POE3, ComIPduGroupRef=ComIPduGroupTx_ECU1_Project, ComIPduSignalRef=ComISignal_ECU1_Msg_POE3_ECU1_Msg_POE3_Sig2, ComIPduSignalRef=ComISignal_ECU1_Msg_POE3_ECU1_Msg_POE3_Sig1
          ComTxIpdu_ComIPdu_ECU1_Msg_POE3 (ComTxIPdu): category=TOOL_CONFIGURED, ComMinimumDelayTime=0.02, ComTxIPduUnusedAreasDefault=0
            ComTxModeTrue_ComTxIpdu_ComIPdu_ECU1_Msg_POE3 (ComTxModeTrue): category=TOOL_CONFIGURED
              ComTxMode_ComTxModeTrue_ComTxIpdu_ComIPdu_ECU1_Msg_POE3 (ComTxMode):
                category = TOOL_CONFIGURED
                ComTxModeMode = MIXED
                ComTxModeNumberOfRepetitions = 3
                ComTxModeRepetitionPeriod = 0.04
                ComTxModeTimeOffset = 0.0
                ComTxModeTimePeriod = 0.2
        ComIPdu_ECU1_Msg_TP1: ComIPduDirection=SEND, ComIPduHandleId=0, ComIPduType=TP, ComPduIdRef=Pdu_ISignalIPdu_ECU1_Msg_TP1, ComIPduGroupRef=ComIPduGroupTx_ECU1_Project, ComIPduSignalRef=ComISignal_ECU1_Msg_TP1_ECU1_Msg_TP1_signal
          ComTxIpdu_ComIPdu_ECU1_Msg_TP1 (ComTxIPdu): category=TOOL_CONFIGURED, ComMinimumDelayTime=0.0, ComTxIPduUnusedAreasDefault=0
            ComTxModeTrue_ComTxIpdu_ComIPdu_ECU1_Msg_TP1 (ComTxModeTrue): category=TOOL_CONFIGURED
              ComTxMode_ComTxModeTrue_ComTxIpdu_ComIPdu_ECU1_Msg_TP1 (ComTxMode): category=TOOL_CONFIGURED, ComTxModeMode=DIRECT, ComTxModeNumberOfRepetitions=0, ComTxModeRepetitionPeriod=0.0
        ComIPdu_ECU1_Msg_TP2: ComIPduDirection=SEND, ComIPduHandleId=1, ComIPduType=TP, ComPduIdRef=Pdu_ISignalIPdu_ECU1_Msg_TP2, ComIPduGroupRef=ComIPduGroupTx_ECU1_Project, ComIPduSignalRef=ComISignal_ECU1_Msg_TP2_ECU1_Msg_TP2_signal
          ComTxIpdu_ComIPdu_ECU1_Msg_TP2 (ComTxIPdu): category=TOOL_CONFIGURED, ComMinimumDelayTime=0.0, ComTxIPduUnusedAreasDefault=0
            ComTxModeTrue_ComTxIpdu_ComIPdu_ECU1_Msg_TP2 (ComTxModeTrue): category=TOOL_CONFIGURED
              ComTxMode_ComTxModeTrue_ComTxIpdu_ComIPdu_ECU1_Msg_TP2 (ComTxMode): category=TOOL_CONFIGURED, ComTxModeMode=DIRECT, ComTxModeNumberOfRepetitions=0, ComTxModeRepetitionPeriod=0.0
        ComIPdu_ECU2_Msg_OE1: ComIPduDirection=RECEIVE, ComIPduHandleId=0, ComIPduType=NORMAL, ComPduIdRef=Pdu_ISignalIPdu_ECU2_Msg_OE1, ComIPduGroupRef=ComIPduGroupRx_ECU1_Project, ComIPduSignalRef=ComISignal_ECU2_Msg_OE1_ECU2_Msg_OE1_Sig1, ComIPduSignalRef=ComISignal_ECU2_Msg_OE1_ECU2_Msg_OE1_Sig2, ComIPduSignalRef=ComISignal_ECU2_Msg_OE1_ECU2_Msg_OE1_Sig3, ComIPduSignalRef=ComISignal_ECU2_Msg_OE1_ECU2_Msg_OE1_Sig4, ComIPduSignalRef=ComISignal_ECU2_Msg_OE1_ECU2_Msg_OE1_Sig5
        ComIPdu_ECU2_Msg_P1: ComIPduDirection=RECEIVE, ComIPduHandleId=1, ComIPduType=NORMAL, ComPduIdRef=Pdu_ISignalIPdu_ECU2_Msg_P1, ComIPduGroupRef=ComIPduGroupRx_ECU1_Project, ComIPduSignalRef=ComISignal_ECU2_Msg_P1_ECU2_Msg_P1_Sig2, ComIPduSignalRef=ComISignal_ECU2_Msg_P1_ECU2_Msg_P1_Sig1
        ComIPdu_ECU2_Msg_PIF1: ComIPduDirection=RECEIVE, ComIPduHandleId=2, ComIPduType=NORMAL, ComPduIdRef=Pdu_ISignalIPdu_ECU2_Msg_PIF1, ComIPduGroupRef=ComIPduGroupRx_ECU1_Project, ComIPduSignalRef=ComISignal_ECU2_Msg_PIF1_ECU2_Msg_PIF1_Sig2, ComIPduSignalRef=ComISignal_ECU2_Msg_PIF1_ECU2_Msg_PIF1_Sig1
        ComIPdu_ECU2_Msg_POE1: ComIPduDirection=RECEIVE, ComIPduHandleId=3, ComIPduType=NORMAL, ComPduIdRef=Pdu_ISignalIPdu_ECU2_Msg_POE1, ComIPduGroupRef=ComIPduGroupRx_ECU1_Project, ComIPduSignalRef=ComISignal_ECU2_Msg_POE1_ECU2_Msg_POE1_Sig1, ComIPduSignalRef=ComISignal_ECU2_Msg_POE1_ECU2_Msg_POE1_Sig2
        ComIPdu_GST_Msg_TP1: ComIPduDirection=RECEIVE, ComIPduHandleId=4, ComIPduType=TP, ComPduIdRef=Pdu_ISignalIPdu_GST_Msg_TP1, ComIPduGroupRef=ComIPduGroupRx_ECU1_Project, ComIPduSignalRef=ComISignal_GST_Msg_TP1_GST_Msg_TP1_signal
        ComIPdu_GST_Msg_TP2: ComIPduDirection=RECEIVE, ComIPduHandleId=5, ComIPduType=TP, ComPduIdRef=Pdu_ISignalIPdu_GST_Msg_TP2, ComIPduGroupRef=ComIPduGroupRx_ECU1_Project, ComIPduSignalRef=ComISignal_GST_Msg_TP2_GST_Msg_TP2_signal
      ComIPduGroupRx_ECU1_Project (ComIPduGroup): category=TOOL_CONFIGURED, ComIPduGroupHandleId=0
      ComIPduGroupTx_ECU1_Project (ComIPduGroup): category=TOOL_CONFIGURED, ComIPduGroupHandleId=1
      30 x ComSignal, all with category=TOOL_CONFIGURED, ComSignalInitValue=0, ComSignalLength=1, ComSignalType=UINT8, ComSigReportIdsMEnable=0:
        ComISignal_ECU1_Msg_GW1_ECU1_Msg_GW1_Sig2: ComBitPosition=15, ComBitSize=8, ComHandleId=4, ComSignalEndianness=BIG_ENDIAN, ComTimeout=0.7, ComTransferProperty=TRIGGERED, ComSystemTemplateSystemSignalRef=ECU1_Msg_GW1_Sig2
        ComISignal_ECU1_Msg_GW1_ECU1_Msg_GW1_Sig1: ComBitPosition=7, ComBitSize=8, ComHandleId=5, ComSignalEndianness=BIG_ENDIAN, ComTimeout=0.7, ComTransferProperty=TRIGGERED, ComSystemTemplateSystemSignalRef=ECU1_Msg_GW1_Sig1
        ComISignal_ECU1_Msg_IF1_ECU1_Msg_IF1_Sig2: ComBitPosition=15, ComBitSize=8, ComHandleId=2, ComSignalEndianness=BIG_ENDIAN, ComTimeout=0.7, ComTransferProperty=TRIGGERED, ComSystemTemplateSystemSignalRef=ECU1_Msg_IF1_Sig2
        ComISignal_ECU1_Msg_IF1_ECU1_Msg_IF1_Sig1: ComBitPosition=7, ComBitSize=8, ComHandleId=3, ComSignalEndianness=BIG_ENDIAN, ComTimeout=0.7, ComTransferProperty=TRIGGERED, ComSystemTemplateSystemSignalRef=ECU1_Msg_IF1_Sig1
        ComISignal_ECU1_Msg_OE1_ECU1_Msg_OE1_Sig2: ComBitPosition=7, ComBitSize=4, ComHandleId=7, ComSignalEndianness=BIG_ENDIAN, ComTimeout=0.7, ComTransferProperty=TRIGGERED_WITHOUT_REPETITION, ComSystemTemplateSystemSignalRef=ECU1_Msg_OE1_Sig2
        ComISignal_ECU1_Msg_OE1_ECU1_Msg_OE1_Sig1: ComBitPosition=3, ComBitSize=4, ComHandleId=6, ComSignalEndianness=BIG_ENDIAN, ComTimeout=0.7, ComTransferProperty=TRIGGERED_WITHOUT_REPETITION, ComSystemTemplateSystemSignalRef=ECU1_Msg_OE1_Sig1
        ComISignal_ECU1_Msg_P1_ECU1_Msg_P1_Sig2: ComBitPosition=15, ComBitSize=8, ComHandleId=11, ComSignalEndianness=BIG_ENDIAN, ComTimeout=0.7, ComTransferProperty=PENDING, ComSystemTemplateSystemSignalRef=ECU1_Msg_P1_Sig2
        ComISignal_ECU1_Msg_P1_ECU1_Msg_P1_Sig1: ComBitPosition=7, ComBitSize=8, ComHandleId=12, ComSignalEndianness=BIG_ENDIAN, ComTimeout=0.7, ComTransferProperty=PENDING, ComSystemTemplateSystemSignalRef=ECU1_Msg_P1_Sig1
        ComISignal_ECU1_Msg_P2_ECU1_Msg_P2_Sig2: ComBitPosition=15, ComBitSize=8, ComHandleId=19, ComSignalEndianness=BIG_ENDIAN, ComTimeout=0.7, ComTransferProperty=PENDING, ComSystemTemplateSystemSignalRef=ECU1_Msg_P2_Sig2
        ComISignal_ECU1_Msg_P2_ECU1_Msg_P2_Sig1: ComBitPosition=7, ComBitSize=8, ComHandleId=20, ComSignalEndianness=BIG_ENDIAN, ComTimeout=0.7, ComTransferProperty=PENDING, ComSystemTemplateSystemSignalRef=ECU1_Msg_P2_Sig1
        ComISignal_ECU1_Msg_P3_ECU1_Msg_P3_Sig2: ComBitPosition=15, ComBitSize=8, ComHandleId=17, ComSignalEndianness=BIG_ENDIAN, ComTimeout=0.7, ComTransferProperty=PENDING, ComSystemTemplateSystemSignalRef=ECU1_Msg_P3_Sig2
        ComISignal_ECU1_Msg_P3_ECU1_Msg_P3_Sig1: ComBitPosition=7, ComBitSize=8, ComHandleId=18, ComSignalEndianness=BIG_ENDIAN, ComTimeout=0.7, ComTransferProperty=PENDING, ComSystemTemplateSystemSignalRef=ECU1_Msg_P3_Sig1
        ComISignal_ECU1_Msg_P4_ECU1_Msg_P4_Sig2: ComBitPosition=15, ComBitSize=8, ComHandleId=15, ComSignalEndianness=BIG_ENDIAN, ComTimeout=0.7, ComTransferProperty=PENDING, ComSystemTemplateSystemSignalRef=ECU1_Msg_P4_Sig2
        ComISignal_ECU1_Msg_P4_ECU1_Msg_P4_Sig1: ComBitPosition=7, ComBitSize=8, ComHandleId=16, ComSignalEndianness=BIG_ENDIAN, ComTimeout=0.7, ComTransferProperty=PENDING, ComSystemTemplateSystemSignalRef=ECU1_Msg_P4_Sig1
        ComISignal_ECU1_Msg_PIF1_ECU1_Msg_PIF1_Sig2: ComBitPosition=15, ComBitSize=8, ComHandleId=13, ComSignalEndianness=BIG_ENDIAN, ComTimeout=0.7, ComTransferProperty=TRIGGERED, ComSystemTemplateSystemSignalRef=ECU1_Msg_PIF1_Sig2
        ComISignal_ECU1_Msg_PIF1_ECU1_Msg_PIF1_Sig1: ComBitPosition=7, ComBitSize=8, ComHandleId=14, ComSignalEndianness=BIG_ENDIAN, ComTimeout=0.7, ComTransferProperty=TRIGGERED, ComSystemTemplateSystemSignalRef=ECU1_Msg_PIF1_Sig1
        ComISignal_ECU1_Msg_POE1_ECU1_Msg_POE1_Sig2: ComBitPosition=15, ComBitSize=8, ComHandleId=23, ComSignalEndianness=BIG_ENDIAN, ComTimeout=0.7, ComTransferProperty=TRIGGERED_ON_CHANGE_WITHOUT_REPETITION, ComSystemTemplateSystemSignalRef=ECU1_Msg_POE1_Sig2
        ComISignal_ECU1_Msg_POE1_ECU1_Msg_POE1_Sig1: ComBitPosition=7, ComBitSize=8, ComHandleId=24, ComSignalEndianness=BIG_ENDIAN, ComTimeout=0.7, ComTransferProperty=TRIGGERED_WITHOUT_REPETITION, ComSystemTemplateSystemSignalRef=ECU1_Msg_POE1_Sig1
        ComISignal_ECU1_Msg_POE2_ECU1_Msg_POE2_Sig2: ComBitPosition=15, ComBitSize=8, ComHandleId=21, ComSignalEndianness=BIG_ENDIAN, ComTimeout=0.7, ComTransferProperty=TRIGGERED_ON_CHANGE, ComSystemTemplateSystemSignalRef=ECU1_Msg_POE2_Sig2
        ComISignal_ECU1_Msg_POE2_ECU1_Msg_POE2_Sig1: ComBitPosition=7, ComBitSize=8, ComHandleId=22, ComSignalEndianness=BIG_ENDIAN, ComTimeout=0.7, ComTransferProperty=TRIGGERED, ComSystemTemplateSystemSignalRef=ECU1_Msg_POE2_Sig1
        ComISignal_ECU1_Msg_POE3_ECU1_Msg_POE3_Sig2: ComBitPosition=15, ComBitSize=8, ComHandleId=25, ComSignalEndianness=BIG_ENDIAN, ComTimeout=0.7, ComTransferProperty=TRIGGERED_ON_CHANGE_WITHOUT_REPETITION, ComSystemTemplateSystemSignalRef=ECU1_Msg_POE3_Sig2
        ComISignal_ECU1_Msg_POE3_ECU1_Msg_POE3_Sig1: ComBitPosition=7, ComBitSize=8, ComHandleId=26, ComSignalEndianness=BIG_ENDIAN, ComTimeout=0.7, ComTransferProperty=TRIGGERED_WITHOUT_REPETITION, ComSystemTemplateSystemSignalRef=ECU1_Msg_POE3_Sig1
        ComISignal_ECU2_Msg_OE1_ECU2_Msg_OE1_Sig2: ComBitPosition=4, ComBitSize=4, ComHandleId=1, ComSignalEndianness=LITTLE_ENDIAN, ComTimeout=0.7, ComTransferProperty=TRIGGERED_WITHOUT_REPETITION, ComNotification=Rte_COMCbk_ComISignal_ECU2_Msg_OE1_ECU2_Msg_OE1_Sig2, ComTimeoutNotification=Rte_COMCbkRxTOut_ComISignal_ECU2_Msg_OE1_ECU2_Msg_OE1_Sig2, ComSystemTemplateSystemSignalRef=ECU2_Msg_OE1_Sig2
        ComISignal_ECU2_Msg_OE1_ECU2_Msg_OE1_Sig1: ComBitPosition=0, ComBitSize=4, ComHandleId=0, ComSignalEndianness=LITTLE_ENDIAN, ComTimeout=0.7, ComTransferProperty=TRIGGERED_WITHOUT_REPETITION, ComNotification=Rte_COMCbk_ComISignal_ECU2_Msg_OE1_ECU2_Msg_OE1_Sig1, ComTimeoutNotification=Rte_COMCbkRxTOut_ComISignal_ECU2_Msg_OE1_ECU2_Msg_OE1_Sig1, ComSystemTemplateSystemSignalRef=ECU2_Msg_OE1_Sig1
        ComISignal_ECU2_Msg_P1_ECU2_Msg_P1_Sig2: ComBitPosition=15, ComBitSize=8, ComHandleId=5, ComSignalEndianness=BIG_ENDIAN, ComTimeout=0.0, ComTransferProperty=PENDING, ComSystemTemplateSystemSignalRef=ECU2_Msg_P1_Sig2
        ComISignal_ECU2_Msg_P1_ECU2_Msg_P1_Sig1: ComBitPosition=7, ComBitSize=8, ComHandleId=6, ComSignalEndianness=BIG_ENDIAN, ComTimeout=0.0, ComTransferProperty=PENDING, ComSystemTemplateSystemSignalRef=ECU2_Msg_P1_Sig1
        ComISignal_ECU2_Msg_PIF1_ECU2_Msg_PIF1_Sig2: ComBitPosition=31, ComBitSize=8, ComHandleId=7, ComSignalEndianness=BIG_ENDIAN, ComTimeout=0.0, ComTransferProperty=TRIGGERED, ComSystemTemplateSystemSignalRef=ECU2_Msg_PIF1_Sig2
        ComISignal_ECU2_Msg_PIF1_ECU2_Msg_PIF1_Sig1: ComBitPosition=23, ComBitSize=8, ComHandleId=8, ComSignalEndianness=BIG_ENDIAN, ComTimeout=0.0, ComTransferProperty=TRIGGERED, ComSystemTemplateSystemSignalRef=ECU2_Msg_PIF1_Sig1
        ComISignal_ECU2_Msg_POE1_ECU2_Msg_POE1_Sig1: ComBitPosition=31, ComBitSize=8, ComHandleId=9, ComSignalEndianness=BIG_ENDIAN, ComTimeout=0.0, ComTransferProperty=TRIGGERED, ComSystemTemplateSystemSignalRef=ECU2_Msg_POE1_Sig1
        ComISignal_ECU2_Msg_POE1_ECU2_Msg_POE1_Sig2: ComBitPosition=23, ComBitSize=8, ComHandleId=10, ComSignalEndianness=BIG_ENDIAN, ComTimeout=0.0, ComTransferProperty=TRIGGERED_ON_CHANGE, ComSystemTemplateSystemSignalRef=ECU2_Msg_POE1_Sig2
      ComTimeBase: category=TOOL_CONFIGURED, ComGwTimeBase=0.005, ComRxTimeBase=0.005, ComTxTimeBase=0.005
      10 x ComSignal, all with category=TOOL_CONFIGURED, ComTransferProperty=TRIGGERED_WITHOUT_REPETITION, ComSigReportIdsMEnable=0:
        ComISignal_ECU1_Msg_TP1_ECU1_Msg_TP1_signal: ComBitPosition=0, ComBitSize=64, ComSignalEndianness=opaque, ComSignalLength=8, ComSignalType=UINT8_N, ComHandleId=0, ComSignalInitValue=0 0 0 0 0 0 0 0, ComSystemTemplateSystemSignalRef=ECU1_Msg_TP1_signal
        ComISignal_ECU1_Msg_TP2_ECU1_Msg_TP2_signal: ComBitPosition=0, ComBitSize=64, ComSignalEndianness=opaque, ComSignalLength=8, ComSignalType=UINT8_N, ComHandleId=1, ComSignalInitValue=0 0 0 0 0 0 0 0, ComSystemTemplateSystemSignalRef=ECU1_Msg_TP2_signal
        ComISignal_GST_Msg_TP1_GST_Msg_TP1_signal: ComBitPosition=0, ComBitSize=64, ComSignalEndianness=opaque, ComSignalLength=8, ComSignalType=UINT8_N, ComHandleId=11, ComTimeout=0.0, ComSignalInitValue=0 0 0 0 0 0 0 0, ComSystemTemplateSystemSignalRef=GST_Msg_TP1_signal
        ComISignal_GST_Msg_TP2_GST_Msg_TP2_signal: ComBitPosition=0, ComBitSize=64, ComSignalEndianness=opaque, ComSignalLength=8, ComSignalType=UINT8_N, ComHandleId=12, ComTimeout=0.0, ComSignalInitValue=0 0 0 0 0 0 0 0, ComSystemTemplateSystemSignalRef=GST_Msg_TP2_signal
        ComISignal_ECU1_Msg_OE1_ECU1_Msg_OE1_Sig3: ComBitPosition=15, ComBitSize=8, ComSignalEndianness=BIG_ENDIAN, ComSignalInitValue=0, ComSignalLength=1, ComSignalType=UINT8, ComHandleId=8, ComTimeout=0.7, ComSystemTemplateSystemSignalRef=ECU1_Msg_OE1_Sig3
        ComISignal_ECU1_Msg_OE1_ECU1_Msg_OE1_Sig4: ComBitPosition=23, ComBitSize=16, ComSignalEndianness=BIG_ENDIAN, ComSignalInitValue=0, ComSignalLength=2, ComSignalType=UINT16, ComHandleId=9, ComTimeout=0.7, ComSystemTemplateSystemSignalRef=ECU1_Msg_OE1_Sig4
        ComISignal_ECU1_Msg_OE1_ECU1_Msg_OE1_Sig5: ComBitPosition=39, ComBitSize=32, ComSignalEndianness=BIG_ENDIAN, ComSignalInitValue=0, ComSignalLength=4, ComSignalType=UINT32, ComHandleId=10, ComTimeout=0.7, ComSystemTemplateSystemSignalRef=ECU1_Msg_OE1_Sig5
        ComISignal_ECU2_Msg_OE1_ECU2_Msg_OE1_Sig3: ComBitPosition=8, ComBitSize=8, ComSignalEndianness=LITTLE_ENDIAN, ComSignalInitValue=0, ComSignalLength=1, ComSignalType=UINT8, ComHandleId=2, ComTimeout=0.7, ComNotification=Rte_COMCbk_ComISignal_ECU2_Msg_OE1_ECU2_Msg_OE1_Sig3, ComTimeoutNotification=Rte_COMCbkRxTOut_ComISignal_ECU2_Msg_OE1_ECU2_Msg_OE1_Sig3, ComSystemTemplateSystemSignalRef=ECU2_Msg_OE1_Sig3
        ComISignal_ECU2_Msg_OE1_ECU2_Msg_OE1_Sig4: ComBitPosition=16, ComBitSize=16, ComSignalEndianness=LITTLE_ENDIAN, ComSignalInitValue=0, ComSignalLength=2, ComSignalType=UINT16, ComHandleId=3, ComTimeout=0.7, ComNotification=Rte_COMCbk_ComISignal_ECU2_Msg_OE1_ECU2_Msg_OE1_Sig4, ComTimeoutNotification=Rte_COMCbkRxTOut_ComISignal_ECU2_Msg_OE1_ECU2_Msg_OE1_Sig4, ComSystemTemplateSystemSignalRef=ECU2_Msg_OE1_Sig4
        ComISignal_ECU2_Msg_OE1_ECU2_Msg_OE1_Sig5: ComBitPosition=32, ComBitSize=32, ComSignalEndianness=LITTLE_ENDIAN, ComSignalInitValue=0, ComSignalLength=4, ComSignalType=UINT32, ComHandleId=4, ComTimeout=0.7, ComNotification=Rte_COMCbk_ComISignal_ECU2_Msg_OE1_ECU2_Msg_OE1_Sig5, ComTimeoutNotification=Rte_COMCbkRxTOut_ComISignal_ECU2_Msg_OE1_ECU2_Msg_OE1_Sig5, ComSystemTemplateSystemSignalRef=ECU2_Msg_OE1_Sig5
    ComGeneral:
      ComConfigurationUseDet = 1
      ComEnableMDTForCyclicTransmission = 1
      ComRetryFailedTransmitRequests = 0
      ComSupportedIPduGroups = 2
      ComVersionInfoApi = 0
      ComMainFunctionBasedTransmit = 1
      ComEnableSignalGroupArrayApi = 0
