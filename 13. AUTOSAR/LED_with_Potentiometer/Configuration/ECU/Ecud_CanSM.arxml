AUTOSAR XML (schema 4-0-3)
package /AUTOSAR
  module config CanSM: implementation-config-variant=VARIANT-PRE-COMPILE, module-description=BswImplementation_CanSM
    CanSMConfiguration: CanSMModeRequestRepetitionMax=0, CanSMModeRequestRepetitionTime=0.0
      CanSMManagerNetwork_Project (CanSMManagerNetwork):
        category = TOOL_CONFIGURED
        CanSMBorCounterL1ToL2 = 0
        CanSMBorTimeL1 = 0.0
        CanSMBorTimeL2 = 0.0
        CanSMBorTimeTxEnsured = 0.0
        CanSMBorTxConfirmationPolling = 0
        CanSMComMNetworkHandleRef = ComMChannel_Project
        CanSMController_ECU1_Project (CanSMController): category=TOOL_CONFIGURED, CanSMControllerId=CanIfCtrlCfg_ECU1_Project
        CanSMDemEventParameterRefs: CANSM_E_BUS_OFF=CANSM_E_BUS_OFF, CANSM_E_MODE_CHANGE=CANSM_E_MODE_CHANGE_PROJECT
    CanSMGeneral: CanSMDevErrorDetect=1, CanSMMainFunctionTimePeriod=0.005, CanSMVersionInfoApi=0, CanSmChangeBaudrateApi=0
